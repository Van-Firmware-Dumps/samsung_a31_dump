/dts-v1/;

/ {
	compatible = "Samsung,A31 KOR SINGLE 03", "Mediatek,MT6768";
	dtbo-hw_rev = <0x3>;
	dtbo-hw_rev_end = <0x20>;

	__fixups__ {
		accdet = "/fragment@9:target:0", "/fragment@90:target:0";
		aud_gpio_i2s1_off = "/fragment@86:target:0";
		aud_gpio_i2s1_on = "/fragment@87:target:0";
		aud_gpio_i2s2_off = "/fragment@88:target:0";
		aud_gpio_i2s2_on = "/fragment@89:target:0";
		auxadc = "/fragment@smd/__overlay__/samsung_mobile_device/sec_thermistor@2:io-channels:0", "/fragment@smd/__overlay__/samsung_mobile_device/sec_thermistor@1:io-channels:0", "/fragment@smd/__overlay__/samsung_mobile_device/sec_thermistor@0:io-channels:0", "/fragment@smd/__overlay__/samsung_mobile_device/battery:io-channels:0", "/fragment@model/__overlay__/sec_thermistor@0:io-channels:0", "/fragment@model/__overlay__/sec_thermistor@1:io-channels:0", "/fragment@model/__overlay__/sec_thermistor@2:io-channels:0", "/fragment@37:target:0", "/fragment@38/__overlay__:io-channels:0", "/fragment@39/__overlay__:io-channels:0", "/fragment@40/__overlay__:io-channels:0", "/fragment@81/__overlay__:io-channels:0", "/fragment@82/__overlay__:io-channels:0";
		camera_af_hw_node = "/fragment@69:target:0";
		chosen = "/fragment@1:target:0";
		consys = "/fragment@14:target:0";
		dsi_te = "/fragment@54:target:0";
		gpio = "/fragment@50:target:0", "/fragment@51:target:0";
		gpio_usage_mapping = "/fragment@49:target:0";
		i2c0 = "/fragment@42:target:0", "/fragment@84:target:0";
		i2c1 = "/fragment@70:target:0";
		i2c2 = "/fragment@7:target:0", "/fragment@71:target:0";
		i2c3 = "/fragment@26:target:0", "/fragment@27:target:0", "/fragment@36:target:0", "/fragment@44:target:0", "/fragment@76:target:0";
		i2c4 = "/fragment@72:target:0";
		i2c5 = "/fragment@34:target:0", "/fragment@45:target:0", "/fragment@74:target:0", "/fragment@94:target:0";
		i2c6 = "/fragment@4:target:0", "/fragment@46:target:0", "/fragment@79:target:0", "/fragment@92:target:0";
		i2c7 = "/fragment@47:target:0", "/fragment@83:target:0";
		i2c8 = "/fragment@48:target:0", "/fragment@73:target:0";
		infracfg_ao = "/fragment@23/__overlay__/etspi-spi@0:clocks:16";
		irtx_pwm = "/fragment@15:target:0";
		kd_camera_hw1 = "/fragment@64:target:0", "/fragment@68:target:0";
		keypad = "/fragment@66:target:0";
		main_pmic = "/fragment@55:target:0";
		md1_sim1_hot_plug_eint = "/fragment@56:target:0";
		md_auxadc = "/fragment@38:target:0";
		mrdump_ext_rst = "/fragment@53:target:0";
		msdc1 = "/fragment@19:target:0", "/fragment@91:target:0";
		mt6358_snd = "/fragment@8:target:0";
		mt6370_pmu = "/fragment@11:target:0";
		mt6370_typec = "/fragment@12:target:0";
		mt_pmic_vcama1_ldo_reg = "/fragment@57:target:0", "/fragment@64/__overlay__:vcama_main3-supply:0", "/fragment@68/__overlay__:cam2_vcama-supply:0";
		mt_pmic_vcama2_ldo_reg = "/fragment@58:target:0", "/fragment@64/__overlay__:vcama-supply:0", "/fragment@78:target:0";
		mt_pmic_vcamd_ldo_reg = "/fragment@61:target:0", "/fragment@64/__overlay__:vcamd_main2-supply:0", "/fragment@68/__overlay__:cam3_vcamd-supply:0";
		mt_pmic_vcamio_ldo_reg = "/fragment@34/__overlay__/sec-nfc@27:nfc_pvdd-supply:0", "/fragment@62:target:0";
		mt_pmic_vldo28_ldo_reg = "/fragment@63:target:0", "/fragment@64/__overlay__:vcamaf-supply:0", "/fragment@68/__overlay__:cam0_vcamaf-supply:0", "/fragment@69/__overlay__:vcamaf-supply:0";
		mt_pmic_vsim1_ldo_reg = "/fragment@59:target:0";
		mt_pmic_vsim2_ldo_reg = "/fragment@60:target:0";
		mtkfb = "/fragment@18:target:0";
		odm = "/fragment@2:target:0";
		pio = "/fragment@smd/__overlay__/fixed_regulator_grip_ldo:gpio:0", "/fragment@smd/__overlay__/fixed_regulator_sensor_ldo:gpio:0", "/fragment@smd/__overlay__/fixed_regulator_btp_ldo:gpio:0", "/fragment@smd/__overlay__/fixed_regulator_rcam4_dvdd_ldo:gpio:0", "/fragment@smd/__overlay__/fixed_regulator_rcam4_avdd_ldo:gpio:0", "/fragment@smd/__overlay__/fixed_regulator_lcd_en_3p0_ldo:gpio:0", "/fragment@smd/__overlay__/fixed_regulator_lcd_en_1p8_ldo:gpio:0", "/fragment@model/__overlay__/shub:mag-check-nfc:0", "/fragment@model/__overlay__/i2c@30:gpios:0", "/fragment@model/__overlay__/i2c@30:gpios:12", "/fragment@model/__overlay__/i2c@23:gpios:0", "/fragment@model/__overlay__/i2c@23:gpios:12", "/fragment@model/__overlay__/i2c@23/sx9360_sub-i2c@28:interrupt-parent:0", "/fragment@model/__overlay__/i2c@23/sx9360_sub-i2c@28:sx9360_sub,nirq-gpio:0", "/fragment@model/__overlay__/i2-gpio-s2mpb03:gpios:0", "/fragment@model/__overlay__/i2-gpio-s2mpb03:gpios:12", "/fragment@3:target:0", "/fragment@4/__overlay__/mms_ts@48:melfas,irq-gpio:0", "/fragment@4/__overlay__/mms_ts@48:melfas,scl-gpio:0", "/fragment@4/__overlay__/mms_ts@48:melfas,sda-gpio:0", "/fragment@6:target:0", "/fragment@9/__overlay__:interrupt-parent:0", "/fragment@9/__overlay__:deb-gpios:0", "/fragment@9/__overlay__:moist-deb-gpios:0", "/fragment@10:target:0", "/fragment@11/__overlay__:mt6370,intr_gpio:0", "/fragment@12/__overlay__:mt6370pd,intr_gpio:0", "/fragment@13:target:0", "/fragment@16:target:0", "/fragment@17:target:0", "/fragment@19/__overlay__:cd-gpios:0", "/fragment@20:target:0", "/fragment@21:target:0", "/fragment@22:target:0", "/fragment@23/__overlay__/etspi-spi@0:etspi-sleepPin:0", "/fragment@23/__overlay__/etspi-spi@0:etspi-ldoPin:0", "/fragment@24:target:0", "/fragment@25:target:0", "/fragment@26/__overlay__/s2mu106@3D:s2mu106,irq-gpio:0", "/fragment@26/__overlay__/s2mu106@3D/s2mu106-haptic:haptic,motor_en:0", "/fragment@27/__overlay__/usbpd-s2mu106@3C:usbpd,usbpd_int:0", "/fragment@28:target:0", "/fragment@29:target:0", "/fragment@30:target:0", "/fragment@31:target:0", "/fragment@32:target:0", "/fragment@33:target:0", "/fragment@34/__overlay__/sec-nfc@27:interrupt-parent:0", "/fragment@34/__overlay__/sec-nfc@27:sec-nfc,irq-gpio:0", "/fragment@34/__overlay__/sec-nfc@27:sec-nfc,ven-gpio:0", "/fragment@34/__overlay__/sec-nfc@27:sec-nfc,firm-gpio:0", "/fragment@34/__overlay__/sec-nfc@27:sec-nfc,clk_req-gpio:0", "/fragment@34/__overlay__/sec-nfc@27:sec-nfc,check_nfc:0", "/fragment@35:target:0", "/fragment@36/__overlay__/s2mu106-fuelgauge@3B:fuelgauge,fuel_int:0", "/fragment@43:target:0", "/fragment@44/__overlay__/s2mu106@3D/flash_led:flash-gpio:0", "/fragment@44/__overlay__/s2mu106@3D/flash_led:torch-gpio:0", "/fragment@49/__overlay__:GPIO_SIM1_HOT_PLUG:0", "/fragment@49/__overlay__:GPIO_SIM2_SIO:0", "/fragment@49/__overlay__:GPIO_SIM2_SRST:0", "/fragment@49/__overlay__:GPIO_SIM2_SCLK:0", "/fragment@49/__overlay__:GPIO_SIM1_SCLK:0", "/fragment@49/__overlay__:GPIO_SIM1_SRST:0", "/fragment@49/__overlay__:GPIO_SIM1_SIO:0", "/fragment@49/__overlay__:GPIO_FDD_BAND_SUPPORT_DETECT_3RD_PIN:0", "/fragment@49/__overlay__:GPIO_FDD_BAND_SUPPORT_DETECT_2ND_PIN:0", "/fragment@49/__overlay__:GPIO_FDD_BAND_SUPPORT_DETECT_1ST_PIN:0", "/fragment@52/__overlay__:interrupt-parent:0", "/fragment@53/__overlay__:interrupt-parent:0", "/fragment@54/__overlay__:interrupt-parent:0", "/fragment@55/__overlay__:interrupt-parent:0", "/fragment@lcd/__overlay__/lcd_fixed_regulator/__gpio_lcd_rst:gpio:0", "/fragment@lcd/__overlay__/lcd_fixed_regulator/__gpio_lcd_1P8_en:gpio:0", "/fragment@lcd/__overlay__/lcd_fixed_regulator/__gpio_lcd_3P0_en:gpio:0", "/fragment@lcd/__overlay__/smcdsd_board_ea8076:gpio_con:0", "/fragment@lcd/__overlay__/smcdsd_board_ea8076:gpio_det:0", "/fragment@lcd/__overlay__/smcdsd_board_ea8076:gpio_pcd:0", "/fragment@lcd/__overlay__/smcdsd_board_ea8076:gpio_err:0", "/fragment@67:target:0", "/fragment@74/__overlay__/sx9360-i2c@28:interrupt-parent:0", "/fragment@74/__overlay__/sx9360-i2c@28:sx9360,nirq-gpio:0", "/fragment@74/__overlay__/sx9360-i2c@28:#sx9360,vdd_en:0", "/fragment@75:target:0", "/fragment@76/__overlay__/s2mu106@3A/s2mu106-haptic:haptic,motor_en:0", "/fragment@77:target:0", "/fragment@79/__overlay__/mms_ts@48:melfas,irq-gpio:0", "/fragment@79/__overlay__/mms_ts@48:melfas,scl-gpio:0", "/fragment@79/__overlay__/mms_ts@48:melfas,sda-gpio:0", "/fragment@79/__overlay__/touchscreen@50:imagis,irq-gpio:0", "/fragment@80:target:0", "/fragment@92/__overlay__/touchscreen@50:imagis,gpio-tsp_fw_det:0", "/fragment@93:target:0";
		pmic_clock_buffer_ctrl = "/fragment@41:target:0";
		reserved_memory = "/fragment@0:target:0";
		sound = "/fragment@85:target:0";
		spi1 = "/fragment@23:target:0";
		tboard_thermistor1 = "/fragment@39:target:0", "/fragment@81:target:0";
		tboard_thermistor2 = "/fragment@40:target:0", "/fragment@82:target:0";
		topckgen = "/fragment@23/__overlay__/etspi-spi@0:clocks:0", "/fragment@23/__overlay__/etspi-spi@0:clocks:8";
		touch = "/fragment@5:target:0", "/fragment@52:target:0", "/fragment@65:target:0";
	};

	__local_fixups__ {

		fragment@14 {

			__overlay__ {
				pinctrl-0 = <0x0>;
				pinctrl-1 = <0x0>;
				pinctrl-2 = <0x0>;
				pinctrl-3 = <0x0>;
			};
		};

		fragment@15 {

			__overlay__ {
				pinctrl-0 = <0x0>;
				pinctrl-1 = <0x0>;
			};
		};

		fragment@18 {

			__overlay__ {
				pinctrl-0 = <0x0>;
				pinctrl-1 = <0x0>;
				pinctrl-2 = <0x0>;
			};
		};

		fragment@23 {

			__overlay__ {

				etspi-spi@0 {
					pinctrl-0 = <0x0 0x4>;
					pinctrl-1 = <0x0 0x4 0x8 0xc>;
					pinctrl-2 = <0x0 0x4 0x8 0xc>;
				};
			};
		};

		fragment@26 {

			__overlay__ {

				s2mu106@3D {
					pinctrl-0 = <0x0>;

					s2mu106-haptic {
						pinctrl-0 = <0x0>;
					};
				};
			};
		};

		fragment@27 {

			__overlay__ {

				usbpd-s2mu106@3C {
					pinctrl-0 = <0x0>;
				};
			};
		};

		fragment@34 {

			__overlay__ {

				sec-nfc@27 {
					pinctrl-0 = <0x0 0x4 0x8 0xc 0x10>;
					pinctrl-1 = <0x0 0x4 0x8 0xc>;
				};
			};
		};

		fragment@36 {

			__overlay__ {

				s2mu106-fuelgauge@3B {
					pinctrl-0 = <0x0>;
				};
			};
		};

		fragment@4 {

			__overlay__ {

				mms_ts@48 {
					pinctrl-0 = <0x0>;
					pinctrl-1 = <0x0>;
					pinctrl-2 = <0x0>;
					pinctrl-3 = <0x0>;
				};
			};
		};

		fragment@5 {

			__overlay__ {
				pinctrl-0 = <0x0>;
				pinctrl-1 = <0x0>;
				pinctrl-2 = <0x0>;
				pinctrl-3 = <0x0>;
				pinctrl-4 = <0x0>;
				pinctrl-5 = <0x0>;
			};
		};

		fragment@68 {

			__overlay__ {
				cam0_vcama-supply = <0x0>;
				cam0_vcamd-supply = <0x0>;
				cam0_vcamio-supply = <0x0>;
				cam1_vcama-supply = <0x0>;
				cam1_vcamd-supply = <0x0>;
				cam1_vcamio-supply = <0x0>;
				cam2_vcamd-supply = <0x0>;
				cam2_vcamio-supply = <0x0>;
				cam3_vcama-supply = <0x0>;
				cam3_vcamio-supply = <0x0>;
				cam4_vcamio-supply = <0x0>;
				pinctrl-0 = <0x0>;
				pinctrl-1 = <0x0>;
				pinctrl-10 = <0x0>;
				pinctrl-11 = <0x0>;
				pinctrl-12 = <0x0>;
				pinctrl-13 = <0x0>;
				pinctrl-14 = <0x0>;
				pinctrl-15 = <0x0>;
				pinctrl-16 = <0x0>;
				pinctrl-17 = <0x0>;
				pinctrl-18 = <0x0>;
				pinctrl-19 = <0x0>;
				pinctrl-2 = <0x0>;
				pinctrl-20 = <0x0>;
				pinctrl-21 = <0x0>;
				pinctrl-22 = <0x0>;
				pinctrl-23 = <0x0>;
				pinctrl-24 = <0x0>;
				pinctrl-25 = <0x0>;
				pinctrl-26 = <0x0>;
				pinctrl-27 = <0x0>;
				pinctrl-28 = <0x0>;
				pinctrl-29 = <0x0>;
				pinctrl-3 = <0x0>;
				pinctrl-30 = <0x0>;
				pinctrl-31 = <0x0>;
				pinctrl-32 = <0x0>;
				pinctrl-33 = <0x0>;
				pinctrl-34 = <0x0>;
				pinctrl-35 = <0x0>;
				pinctrl-36 = <0x0>;
				pinctrl-37 = <0x0>;
				pinctrl-38 = <0x0>;
				pinctrl-39 = <0x0>;
				pinctrl-4 = <0x0>;
				pinctrl-40 = <0x0>;
				pinctrl-41 = <0x0>;
				pinctrl-5 = <0x0>;
				pinctrl-6 = <0x0>;
				pinctrl-7 = <0x0>;
				pinctrl-8 = <0x0>;
				pinctrl-9 = <0x0>;
			};
		};

		fragment@71 {

			__overlay__ {

				camera_sub@1a {
					pinctrl-0 = <0x0 0x4>;
					pinctrl-1 = <0x0 0x4>;
				};
			};
		};

		fragment@72 {

			__overlay__ {

				camera_main@1a {
					pinctrl-0 = <0x0 0x4>;
					pinctrl-1 = <0x0 0x4>;
				};
			};
		};

		fragment@73 {

			__overlay__ {

				camera_main_four@3f {
					pinctrl-0 = <0x0 0x4>;
					pinctrl-1 = <0x0 0x4>;
				};

				camera_main_three@2d {
					pinctrl-0 = <0x0 0x4>;
					pinctrl-1 = <0x0 0x4>;
				};

				camera_main_two@37 {
					pinctrl-0 = <0x0 0x4>;
					pinctrl-1 = <0x0 0x4>;
				};
			};
		};

		fragment@74 {

			__overlay__ {
				pinctrl-0 = <0x0>;

				sx9360-i2c@28 {
					pinctrl-0 = <0x0>;
				};
			};
		};

		fragment@79 {

			__overlay__ {

				mms_ts@48 {
					pinctrl-0 = <0x0>;
					pinctrl-1 = <0x0>;
					pinctrl-2 = <0x0>;
					pinctrl-3 = <0x0>;
				};

				touchscreen@50 {
					pinctrl-0 = <0x0>;
				};
			};
		};

		fragment@85 {

			__overlay__ {

				mediatek,speaker-codec {
					sound-dai = <0x0>;
				};
			};
		};

		fragment@9 {

			__overlay__ {
				pinctrl-0 = <0x0>;
				pinctrl-1 = <0x0>;
				pinctrl-2 = <0x0>;
			};
		};

		fragment@92 {

			__overlay__ {

				touchscreen@50 {
					pinctrl-0 = <0x0 0x4>;
				};
			};
		};

		fragment@lcd {

			__overlay__ {

				ea8076 {
					smcdsd_board = <0x0>;
				};

				panel {
					smcdsd_panel = <0x0>;
				};
			};
		};

		fragment@model {

			__overlay__ {

				i2-gpio-s2mpb03 {
					pinctrl-0 = <0x0>;
				};

				i2c@23 {
					pinctrl-0 = <0x0>;

					sx9360_sub-i2c@28 {
						pinctrl-0 = <0x0>;
					};
				};

				i2c@30 {
					pinctrl-0 = <0x0 0x4>;
				};
			};
		};
	};

	__symbols__ {
		__gpio_lcd_1P8_en = "/fragment@lcd/__overlay__/lcd_fixed_regulator/__gpio_lcd_1P8_en";
		__gpio_lcd_3P0_en = "/fragment@lcd/__overlay__/lcd_fixed_regulator/__gpio_lcd_3P0_en";
		__gpio_lcd_rst = "/fragment@lcd/__overlay__/lcd_fixed_regulator/__gpio_lcd_rst";
		accdet_pins_default = "/fragment@10/__overlay__/accdetdefault";
		accdet_pins_eint_as_int = "/fragment@10/__overlay__/accdeteint@0";
		accdet_pins_moisteint = "/fragment@10/__overlay__/accdetmoisteint@1";
		attn_input = "/fragment@3/__overlay__/attn-input";
		attn_irq = "/fragment@3/__overlay__/attn-irq";
		attn_tsp_ldo_dis_en = "/fragment@3/__overlay__/attn-tsp_ldo_dis_en";
		attn_tsp_ldo_en = "/fragment@3/__overlay__/attn-tsp_ldo_en";
		btp_ldo_en = "/fragment@22/__overlay__/btp_ldo_enable";
		btp_sleep = "/fragment@22/__overlay__/btp_sleep_enable";
		camera0_mclk_2mA = "/fragment@67/__overlay__/camera0_mclk_2mA@gpio99";
		camera0_mclk_4mA = "/fragment@67/__overlay__/camera0_mclk_4mA@gpio99";
		camera0_mclk_6mA = "/fragment@67/__overlay__/camera0_mclk_6mA@gpio99";
		camera0_mclk_8mA = "/fragment@67/__overlay__/camera0_mclk_8mA@gpio99";
		camera0_mclk_off = "/fragment@67/__overlay__/camera0_mclk_gpio_mode@gpio99";
		camera0_rst_high = "/fragment@67/__overlay__/camera0_rst_output_high@gpio102";
		camera0_rst_low = "/fragment@67/__overlay__/camera0_rst_output_low@gpio102";
		camera1_mclk_2mA = "/fragment@67/__overlay__/camera1_mclk_2mA@gpio111";
		camera1_mclk_4mA = "/fragment@67/__overlay__/camera1_mclk_4mA@gpio111";
		camera1_mclk_6mA = "/fragment@67/__overlay__/camera1_mclk_6mA@gpio111";
		camera1_mclk_8mA = "/fragment@67/__overlay__/camera1_mclk_8mA@gpio111";
		camera1_mclk_off = "/fragment@67/__overlay__/camera1_mclk_gpio_mode@gpio111";
		camera1_rst_high = "/fragment@67/__overlay__/camera1_rst_output_high@gpio20";
		camera1_rst_low = "/fragment@67/__overlay__/camera1_rst_output_low@gpio20";
		camera2_mclk_2mA = "/fragment@67/__overlay__/camera2_mclk_2mA@gpio108";
		camera2_mclk_4mA = "/fragment@67/__overlay__/camera2_mclk_4mA@gpio108";
		camera2_mclk_6mA = "/fragment@67/__overlay__/camera2_mclk_6mA@gpio108";
		camera2_mclk_8mA = "/fragment@67/__overlay__/camera2_mclk_8mA@gpio108";
		camera2_mclk_off = "/fragment@67/__overlay__/camera2_mclk_gpio_mode@gpio108";
		camera2_rst_high = "/fragment@67/__overlay__/camera2_rst_output_high@gpio27";
		camera2_rst_low = "/fragment@67/__overlay__/camera2_rst_output_low@gpio27";
		camera3_mclk_2mA = "/fragment@67/__overlay__/camera3_mclk_2mA@gpio100";
		camera3_mclk_4mA = "/fragment@67/__overlay__/camera3_mclk_4mA@gpio100";
		camera3_mclk_6mA = "/fragment@67/__overlay__/camera3_mclk_6mA@gpio100";
		camera3_mclk_8mA = "/fragment@67/__overlay__/camera3_mclk_8mA@gpio100";
		camera3_mclk_off = "/fragment@67/__overlay__/camera3_mclk_gpio_mode@gpio100";
		camera3_rst_high = "/fragment@67/__overlay__/camera3_rst_output_high@gpio101";
		camera3_rst_low = "/fragment@67/__overlay__/camera3_rst_output_low@gpio101";
		camera4_mclk_2mA = "/fragment@67/__overlay__/camera4_mclk_2mA@gpio108";
		camera4_mclk_4mA = "/fragment@67/__overlay__/camera4_mclk_4mA@gpio108";
		camera4_mclk_6mA = "/fragment@67/__overlay__/camera4_mclk_6mA@gpio108";
		camera4_mclk_8mA = "/fragment@67/__overlay__/camera4_mclk_8mA@gpio108";
		camera4_mclk_off = "/fragment@67/__overlay__/camera4_mclk_gpio_mode@gpio108";
		camera4_rst_high = "/fragment@67/__overlay__/camera4_rst_output_high@gpio109";
		camera4_rst_low = "/fragment@67/__overlay__/camera4_rst_output_low@gpio109";
		camera4_vcama_off = "/fragment@67/__overlay__/camera4_vcama_output_low@gpio98";
		camera4_vcama_on = "/fragment@67/__overlay__/camera4_vcama_output_high@gpio98";
		camera4_vcamd_off = "/fragment@67/__overlay__/camera4_vcamd_output_low@gpio29";
		camera4_vcamd_on = "/fragment@67/__overlay__/camera4_vcamd_output_high@gpio29";
		camera_main_af_mtk = "/fragment@70/__overlay__/camera_main_af@0c";
		camera_main_eeprom_mtk = "/fragment@70/__overlay__/camera_main_eeprom@58";
		camera_main_four_i2c_scl_off = "/fragment@67/__overlay__/camera_main_four_i2c_scl_off@gpio24";
		camera_main_four_i2c_scl_on = "/fragment@67/__overlay__/camera_main_four_i2c_scl_on@gpio24";
		camera_main_four_i2c_sda_off = "/fragment@67/__overlay__/camera_main_four_i2c_sda_off@gpio22";
		camera_main_four_i2c_sda_on = "/fragment@67/__overlay__/camera_main_four_i2c_sda_on@gpio22";
		camera_main_four_mtk = "/fragment@73/__overlay__/camera_main_four@3f";
		camera_main_i2c_scl_off = "/fragment@67/__overlay__/camera_main_i2c_scl_off@gpio105";
		camera_main_i2c_scl_on = "/fragment@67/__overlay__/camera_main_i2c_scl_on@gpio105";
		camera_main_i2c_sda_off = "/fragment@67/__overlay__/camera_main_i2c_sda_off@gpio106";
		camera_main_i2c_sda_on = "/fragment@67/__overlay__/camera_main_i2c_sda_on@gpio106";
		camera_main_mtk = "/fragment@72/__overlay__/camera_main@1a";
		camera_main_three_i2c_scl_off = "/fragment@67/__overlay__/camera_main_three_i2c_scl_off@gpio24";
		camera_main_three_i2c_scl_on = "/fragment@67/__overlay__/camera_main_three_i2c_scl_on@gpio24";
		camera_main_three_i2c_sda_off = "/fragment@67/__overlay__/camera_main_three_i2c_sda_off@gpio22";
		camera_main_three_i2c_sda_on = "/fragment@67/__overlay__/camera_main_three_i2c_sda_on@gpio22";
		camera_main_three_mtk = "/fragment@73/__overlay__/camera_main_three@2d";
		camera_main_two_eeprom_mtk = "/fragment@70/__overlay__/camera_main_two_eeprom@54";
		camera_main_two_i2c_scl_off = "/fragment@67/__overlay__/camera_main_two_i2c_scl_off@gpio24";
		camera_main_two_i2c_scl_on = "/fragment@67/__overlay__/camera_main_two_i2c_scl_on@gpio24";
		camera_main_two_i2c_sda_off = "/fragment@67/__overlay__/camera_main_two_i2c_sda_off@gpio22";
		camera_main_two_i2c_sda_on = "/fragment@67/__overlay__/camera_main_two_i2c_sda_on@gpio22";
		camera_main_two_mtk = "/fragment@73/__overlay__/camera_main_two@37";
		camera_mipi_sw_sel_off = "/fragment@67/__overlay__/camera_mipi_sw_sel_low@gpio91";
		camera_mipi_sw_sel_on = "/fragment@67/__overlay__/camera_mipi_sw_sel_high@gpio91";
		camera_pins_default = "/fragment@67/__overlay__/camdefault";
		camera_sub_eeprom_mtk = "/fragment@70/__overlay__/camera_sub_eeprom@51";
		camera_sub_i2c_scl_off = "/fragment@67/__overlay__/camera_sub_i2c_scl_off@gpio103";
		camera_sub_i2c_scl_on = "/fragment@67/__overlay__/camera_sub_i2c_scl_on@gpio103";
		camera_sub_i2c_sda_off = "/fragment@67/__overlay__/camera_sub_i2c_sda_off@gpio104";
		camera_sub_i2c_sda_on = "/fragment@67/__overlay__/camera_sub_i2c_sda_on@gpio104";
		camera_sub_mtk = "/fragment@71/__overlay__/camera_sub@1a";
		clk_req_nc = "/fragment@31/__overlay__/clk_req_nc";
		consys_pins_default = "/fragment@13/__overlay__/consys_default";
		ctp_pins_default = "/fragment@6/__overlay__/eint0default";
		ctp_pins_eint_as_int = "/fragment@6/__overlay__/eint@0";
		ctp_pins_eint_output0 = "/fragment@6/__overlay__/eintoutput0";
		ctp_pins_eint_output1 = "/fragment@6/__overlay__/eintoutput1";
		ctp_pins_rst_output0 = "/fragment@6/__overlay__/rstoutput0";
		ctp_pins_rst_output1 = "/fragment@6/__overlay__/rstoutput1";
		ea8076 = "/fragment@lcd/__overlay__/ea8076";
		fg_alert_default = "/fragment@35/__overlay__/fg_alert_default";
		firm_nc = "/fragment@30/__overlay__/firm_nc";
		fw_det_active = "/fragment@93/__overlay__/fw_det_active";
		gpio_i2c_0_scl_default = "/fragment@21/__overlay__/gpio_i2c_0_scl/gpio_i2c_0_scl_default";
		gpio_i2c_0_sda_default = "/fragment@20/__overlay__/gpio_i2c_0_sda/gpio_i2c_0_sda_default";
		gpslna_pins_init = "/fragment@13/__overlay__/gpslna@0";
		gpslna_pins_oh = "/fragment@13/__overlay__/gpslna@1";
		gpslna_pins_ol = "/fragment@13/__overlay__/gpslna@2";
		grip_int = "/fragment@75/__overlay__/grip-int";
		grip_ldo_en = "/fragment@75/__overlay__/grip-ldo-en";
		grip_sub_i2c = "/fragment@75/__overlay__/grip-sub-i2c";
		grip_sub_int = "/fragment@75/__overlay__/grip-sub-int";
		i2c23 = "/fragment@model/__overlay__/i2c@23";
		if_pmic_irq = "/fragment@24/__overlay__/if_pmic_irq";
		irq_nc = "/fragment@32/__overlay__/irq_nc";
		irtx_gpio_led_default = "/fragment@16/__overlay__/irtx_gpio_led_def@gpio12";
		irtx_gpio_led_set = "/fragment@16/__overlay__/irtx_gpio_led_set@gpio12";
		lcd_fixed_regulator = "/fragment@lcd/__overlay__/lcd_fixed_regulator";
		led0 = "/fragment@2/__overlay__/led@0";
		led1 = "/fragment@2/__overlay__/led@1";
		led2 = "/fragment@2/__overlay__/led@2";
		led3 = "/fragment@2/__overlay__/led@3";
		led4 = "/fragment@2/__overlay__/led@4";
		led5 = "/fragment@2/__overlay__/led@5";
		led6 = "/fragment@2/__overlay__/led@6";
		motor_en = "/fragment@43/__overlay__/motor_en";
		mtkfb_pins_lcm_dsi_te = "/fragment@17/__overlay__/lcm_dsi_te";
		mtkfb_pins_lcm_rst_out0_gpio = "/fragment@17/__overlay__/lcm_rst_out0_gpio";
		mtkfb_pins_lcm_rst_out1_gpio = "/fragment@17/__overlay__/lcm_rst_out1_gpio";
		nfc_check = "/fragment@33/__overlay__/nfc_check";
		nfc_clk_req = "/fragment@31/__overlay__/nfc_clk_req";
		nfc_firm = "/fragment@30/__overlay__/nfc_firm";
		nfc_irq = "/fragment@32/__overlay__/nfc_irq";
		nfc_ven = "/fragment@29/__overlay__/nfc_ven";
		s2mpb03_0_l1 = "/fragment@model/__overlay__/i2c@30/s2mpb03_pmic@56/regulators/s2mpb03-ldo1";
		s2mpb03_0_l2 = "/fragment@model/__overlay__/i2c@30/s2mpb03_pmic@56/regulators/s2mpb03-ldo2";
		s2mpb03_0_l3 = "/fragment@model/__overlay__/i2c@30/s2mpb03_pmic@56/regulators/s2mpb03-ldo3";
		s2mpb03_0_l4 = "/fragment@model/__overlay__/i2c@30/s2mpb03_pmic@56/regulators/s2mpb03-ldo4";
		s2mpb03_0_l5 = "/fragment@model/__overlay__/i2c@30/s2mpb03_pmic@56/regulators/s2mpb03-ldo5";
		s2mpb03_0_l6 = "/fragment@model/__overlay__/i2c@30/s2mpb03_pmic@56/regulators/s2mpb03-ldo6";
		s2mpb03_0_l7 = "/fragment@model/__overlay__/i2c@30/s2mpb03_pmic@56/regulators/s2mpb03-ldo7";
		s2mpb03_i2c_default = "/fragment@80/__overlay__/s2mpb03_i2c_default";
		s2mpb03_l1 = "/fragment@model/__overlay__/i2-gpio-s2mpb03/s2mpb03@56/regulators/s2mpb03-ldo1";
		s2mpb03_l2 = "/fragment@model/__overlay__/i2-gpio-s2mpb03/s2mpb03@56/regulators/s2mpb03-ldo2";
		s2mpb03_l3 = "/fragment@model/__overlay__/i2-gpio-s2mpb03/s2mpb03@56/regulators/s2mpb03-ldo3";
		s2mpb03_l4 = "/fragment@model/__overlay__/i2-gpio-s2mpb03/s2mpb03@56/regulators/s2mpb03-ldo4";
		s2mpb03_l5 = "/fragment@model/__overlay__/i2-gpio-s2mpb03/s2mpb03@56/regulators/s2mpb03-ldo5";
		s2mpb03_l6 = "/fragment@model/__overlay__/i2-gpio-s2mpb03/s2mpb03@56/regulators/s2mpb03-ldo6";
		s2mpb03_l7 = "/fragment@model/__overlay__/i2-gpio-s2mpb03/s2mpb03@56/regulators/s2mpb03-ldo7";
		s2mu106 = "/fragment@26/__overlay__/s2mu106@3D";
		s2mu106_battery_params = "/fragment@smd/__overlay__/samsung_mobile_device/battery_params";
		s2mu106_charger = "/fragment@smd/__overlay__/samsung_mobile_device/s2mu106-charger";
		s2mu106_fuelgauge = "/fragment@36/__overlay__/s2mu106-fuelgauge@3B";
		sec_ap_thermistor = "/fragment@smd/__overlay__/samsung_mobile_device/sec_thermistor@0";
		sec_battery = "/fragment@smd/__overlay__/samsung_mobile_device/battery";
		sec_battery_cable = "/fragment@smd/__overlay__/samsung_mobile_device/cable-info";
		sec_nfc = "/fragment@34/__overlay__/sec-nfc@27";
		sec_pa_thermistor = "/fragment@smd/__overlay__/samsung_mobile_device/sec_thermistor@1";
		sec_wf_thermistor = "/fragment@smd/__overlay__/samsung_mobile_device/sec_thermistor@2";
		sma1303_amp = "/fragment@84/__overlay__/sma1303@1e";
		smcdsd_board_ea8076 = "/fragment@lcd/__overlay__/smcdsd_board_ea8076";
		smd = "/fragment@smd/__overlay__/samsung_mobile_device";
		speaker_amp = "/fragment@83/__overlay__/speaker_amp@34";
		spi1_clr_clk = "/fragment@22/__overlay__/clr_clk";
		spi1_clr_cs = "/fragment@22/__overlay__/clr_cs";
		spi1_clr_miso = "/fragment@22/__overlay__/clr_miso";
		spi1_clr_mosi = "/fragment@22/__overlay__/clr_mosi";
		spi1_set_clk = "/fragment@22/__overlay__/set_clk";
		spi1_set_cs = "/fragment@22/__overlay__/set_cs";
		spi1_set_miso = "/fragment@22/__overlay__/set_miso";
		spi1_set_mosi = "/fragment@22/__overlay__/set_mosi";
		sw_i2c0 = "/fragment@model/__overlay__/i2c@30";
		tsp_irq_active = "/fragment@77/__overlay__/tsp_irq_active";
		usbpd_irq = "/fragment@25/__overlay__/usbpd_irq";
		ven_nc = "/fragment@29/__overlay__/ven_nc";
		vib_en_gpio = "/fragment@28/__overlay__/vib_en_gpio";
		vibrator0 = "/fragment@2/__overlay__/vibrator@0";
	};

	fragment@0 {
		target = <0xffffffff>;

		__overlay__ {

			reserve-memory-scp_share {
				alignment = <0x0 0x1000000>;
				alloc-ranges = <0x0 0x40000000 0x0 0x50000000>;
				compatible = "mediatek,reserve-memory-scp_share";
				no-map;
				size = <0x0 0x300000>;
			};
		};
	};

	fragment@1 {
		target = <0xffffffff>;

		__overlay__ {
			atag,videolfb-fb_base_h = <0x0>;
			atag,videolfb-fb_base_l = "~`P";
			atag,videolfb-fps = <0x1770>;
			atag,videolfb-islcm_inited = <0x0>;
			atag,videolfb-islcmfound = <0x1>;
			atag,videolfb-lcmname = "hx83112b_fhdp_dsi_cmd_auo_rt5081_drv";
			atag,videolfb-vramSize = <0x17e8000>;
		};
	};

	fragment@10 {
		target = <0xffffffff>;

		__overlay__ {

			accdetdefault {
				phandle = <0x10>;
			};

			accdeteint@0 {
				phandle = <0x11>;

				pins_cmd_dat {
					bias-disable;
					input-enable;
					pinmux = <0xc00>;
					slew-rate = <0x0>;
				};
			};

			accdetmoisteint@1 {
				phandle = <0x12>;

				pins_cmd_dat {
					bias-disable;
					input-enable;
					pinmux = <0x2900>;
					slew-rate = <0x0>;
				};
			};
		};
	};

	fragment@11 {
		target = <0xffffffff>;

		__overlay__ {
			mt6370,intr_gpio = <0xffffffff 0x14 0x0>;
			mt6370,intr_gpio_num = <0x14>;
		};
	};

	fragment@12 {
		target = <0xffffffff>;

		__overlay__ {
			mt6370pd,intr_gpio = <0xffffffff 0x29 0x0>;
			mt6370pd,intr_gpio_num = <0x29>;
		};
	};

	fragment@13 {
		target = <0xffffffff>;

		__overlay__ {

			consys_default {
				phandle = <0x13>;
			};

			gpslna@0 {
				phandle = <0x14>;

				pins_cmd_dat {
					bias-disable;
					output-low;
					pinmux = <0xa600>;
					slew-rate = <0x1>;
				};
			};

			gpslna@1 {
				phandle = <0x15>;

				pins_cmd_dat {
					output-high;
					pinmux = <0xa600>;
					slew-rate = <0x1>;
				};
			};

			gpslna@2 {
				phandle = <0x16>;

				pins_cmd_dat {
					output-low;
					pinmux = <0xa600>;
					slew-rate = <0x1>;
				};
			};
		};
	};

	fragment@14 {
		target = <0xffffffff>;

		__overlay__ {
			pinctrl-0 = <0x13>;
			pinctrl-1 = <0x14>;
			pinctrl-2 = <0x15>;
			pinctrl-3 = <0x16>;
			pinctrl-names = "default", "gps_lna_state_init", "gps_lna_state_oh", "gps_lna_state_ol";
			status = "okay";
		};
	};

	fragment@15 {
		target = <0xffffffff>;

		__overlay__ {
			pinctrl-0 = <0x17>;
			pinctrl-1 = <0x18>;
			pinctrl-names = "irtx_gpio_led_default", "irtx_gpio_led_set";
			status = "okay";
		};
	};

	fragment@16 {
		target = <0xffffffff>;

		__overlay__ {

			irtx_gpio_led_def@gpio12 {
				phandle = <0x17>;

				pins_cmd_dat {
					bias-disable;
					input-schmitt-enable = <0x0>;
					output-low;
					pinmux = <0xc00>;
					slew-rate = <0x1>;
				};
			};

			irtx_gpio_led_set@gpio12 {
				phandle = <0x18>;

				pins_cmd_dat {
					output-high;
					pinmux = <0xc01>;
					slew-rate = <0x1>;
				};
			};
		};
	};

	fragment@17 {
		target = <0xffffffff>;

		__overlay__ {

			lcm_dsi_te {
				phandle = <0x1b>;

				pins_cmd_dat {
					pinmux = <0x2c01>;
				};
			};

			lcm_rst_out0_gpio {
				phandle = <0x1a>;

				pins_cmd_dat {
					output-low;
					pinmux = <0x2d00>;
					slew-rate = <0x1>;
				};
			};

			lcm_rst_out1_gpio {
				phandle = <0x19>;

				pins_cmd_dat {
					output-high;
					pinmux = <0x2d00>;
					slew-rate = <0x1>;
				};
			};
		};
	};

	fragment@18 {
		target = <0xffffffff>;

		__overlay__ {
			pinctrl-0 = <0x19>;
			pinctrl-1 = <0x1a>;
			pinctrl-2 = <0x1b>;
			pinctrl-names = "lcm_rst_out1_gpio", "lcm_rst_out0_gpio", "mode_te_te";
			status = "okay";
		};
	};

	fragment@19 {
		target = <0xffffffff>;

		__overlay__ {
			cd-gpios = <0xffffffff 0x9 0x0>;
			cd_level = [01];
		};
	};

	fragment@2 {
		target = <0xffffffff>;

		__overlay__ {

			led@0 {
				compatible = "mediatek,red";
				data = <0x1>;
				led_mode = <0x0>;
				phandle = <0x90>;
				pwm_config = <0x0 0x0 0x0 0x0 0x0>;
			};

			led@1 {
				compatible = "mediatek,green";
				data = <0x1>;
				led_mode = <0x0>;
				phandle = <0x91>;
				pwm_config = <0x0 0x0 0x0 0x0 0x0>;
			};

			led@2 {
				compatible = "mediatek,blue";
				data = <0x1>;
				led_mode = <0x0>;
				phandle = <0x92>;
				pwm_config = <0x0 0x0 0x0 0x0 0x0>;
			};

			led@3 {
				compatible = "mediatek,jogball-backlight";
				data = <0x1>;
				led_mode = <0x0>;
				phandle = <0x93>;
				pwm_config = <0x0 0x0 0x0 0x0 0x0>;
			};

			led@4 {
				compatible = "mediatek,keyboard-backlight";
				data = <0x1>;
				led_mode = <0x0>;
				phandle = <0x94>;
				pwm_config = <0x0 0x0 0x0 0x0 0x0>;
			};

			led@5 {
				compatible = "mediatek,button-backlight";
				data = <0x1>;
				led_mode = <0x0>;
				phandle = <0x95>;
				pwm_config = <0x0 0x0 0x0 0x0 0x0>;
			};

			led@6 {
				compatible;
				data = <0x1>;
				led_mode = <0x5>;
				phandle = <0x96>;
				pwm_config = <0x0 0x3 0x0 0x0 0x0>;
			};

			vibrator@0 {
				compatible = "mediatek,vibrator";
				phandle = <0x97>;
				vib_limit = <0x9>;
				vib_timer = <0x19>;
				vib_vol = <0x9>;
			};
		};
	};

	fragment@20 {
		target = <0xffffffff>;

		__overlay__ {

			gpio_i2c_0_sda {

				gpio_i2c_0_sda_default {
					phandle = <0x1>;

					pins_cmd_dat {
						bias-disable;
						drive-strength = <0x2>;
						input-enable;
						pinmux = <0x5000>;
					};
				};
			};
		};
	};

	fragment@21 {
		target = <0xffffffff>;

		__overlay__ {

			gpio_i2c_0_scl {

				gpio_i2c_0_scl_default {
					phandle = <0x2>;

					pins_cmd_dat {
						bias-disable;
						drive-strength = <0x2>;
						input-enable;
						pinmux = <0x4f00>;
					};
				};
			};
		};
	};

	fragment@22 {
		target = <0xffffffff>;

		__overlay__ {

			btp_ldo_enable {
				phandle = <0x1d>;

				pins_cmd_dat {
					bias-pull-down;
					drive-strength = <0x1>;
					pinmux = <0x4d00>;
				};
			};

			btp_sleep_enable {
				phandle = <0x1c>;

				pins_cmd_dat {
					bias-pull-down;
					drive-strength = <0x1>;
					pinmux = <0x3500>;
				};
			};

			clr_clk {
				phandle = <0x25>;

				pins_cmd_dat {
					bias-pull-down;
					drive-strength = <0x1>;
					output-low;
					pinmux = <0x5800>;
					slew-rate = <0x0>;
				};
			};

			clr_cs {
				phandle = <0x23>;

				pins_cmd_dat {
					bias-pull-down;
					drive-strength = <0x1>;
					output-low;
					pinmux = <0x5600>;
					slew-rate = <0x0>;
				};
			};

			clr_miso {
				phandle = <0x22>;

				pins_cmd_dat {
					bias-pull-down;
					drive-strength = <0x1>;
					input-enable;
					pinmux = <0x5500>;
					slew-rate = <0x0>;
				};
			};

			clr_mosi {
				phandle = <0x24>;

				pins_cmd_dat {
					bias-pull-down;
					drive-strength = <0x1>;
					output-low;
					pinmux = <0x5700>;
					slew-rate = <0x0>;
				};
			};

			set_clk {
				phandle = <0x21>;

				pins_cmd_dat {
					drive-strength = <0x4>;
					pinmux = <0x5801>;
				};
			};

			set_cs {
				phandle = <0x1f>;

				pins_cmd_dat {
					drive-strength = <0x4>;
					pinmux = <0x5601>;
				};
			};

			set_miso {
				phandle = <0x1e>;

				pins_cmd_dat {
					drive-strength = <0x4>;
					pinmux = <0x5501>;
				};
			};

			set_mosi {
				phandle = <0x20>;

				pins_cmd_dat {
					drive-strength = <0x4>;
					pinmux = <0x5701>;
				};
			};
		};
	};

	fragment@23 {
		target = <0xffffffff>;

		__overlay__ {
			#address-cells = <0x1>;
			#size-cells = <0x0>;
			status = "okay";

			etspi-spi@0 {
				#gpio-cells = <0x2>;
				clock-names = "parent-clk", "sel-clk", "spi-clk";
				clocks = <0xffffffff 0xb 0xffffffff 0x5b 0xffffffff 0x34>;
				compatible = "etspi,et7xx";
				etspi-chipid = "ET713";
				etspi-ldoPin = <0xffffffff 0x4d 0x0>;
				etspi-modelinfo = "A315";
				etspi-position = "8.97,0.00,9.10,9.10,14.80,14.80,12.00,12.00,5.00";
				etspi-rb = "525,-1,-1";
				etspi-sleepPin = <0xffffffff 0x35 0x0>;
				gpio-controller;
				pinctrl-0 = <0x1c 0x1d>;
				pinctrl-1 = <0x1e 0x1f 0x20 0x21>;
				pinctrl-2 = <0x22 0x23 0x24 0x25>;
				pinctrl-names = "default", "pins_poweron", "pins_poweroff";
				reg = <0x0>;
				spi-max-frequency = <0x17d7840>;

				controller-data {
					mediatek,tckdly = <0x1>;
				};
			};
		};
	};

	fragment@24 {
		target = <0xffffffff>;

		__overlay__ {

			if_pmic_irq {
				phandle = <0x26>;

				pins_cmd_dat {
					bias-disable;
					pinmux = <0x700>;
					slew-rate = <0x1>;
				};
			};
		};
	};

	fragment@25 {
		target = <0xffffffff>;

		__overlay__ {

			usbpd_irq {
				phandle = <0x28>;

				pins_cmd_dat {
					bias-disable;
					pinmux = <0x0>;
					slew-rate = <0x1>;
				};
			};
		};
	};

	fragment@26 {
		target = <0xffffffff>;

		__overlay__ {
			#address-cells = <0x1>;
			#size-cells = <0x0>;
			clock-frequency = <0x61a80>;
			mediatek,use-open-drain;

			s2mu106@3D {
				compatible = "samsung,s2mu106mfd";
				phandle = <0x98>;
				pinctrl-0 = <0x26>;
				pinctrl-names = "default";
				reg = <0x3d>;
				s2mu106,irq-gpio = <0xffffffff 0x7 0x1>;
				s2mu106,wakeup;
				status = "okay";

				s2mu106-haptic {
					compatible = "sec,s2mu106-haptic";
					haptic,motor_en = <0xffffffff 0x96 0x0>;
					haptic,motor_strength = "0x66";
					haptic,motor_type = "COINDC";
					haptic,operation_mode = <0x1>;
					pinctrl-0 = <0x27>;
					pinctrl-names = "default";
					samsung,haptic_intensities = <0x0 0x7d0 0xfa0 0x1770 0x1f40 0x2710>;
					samsung,intensities = <0x0 0xbb8 0xfa0 0x1770 0x1f40 0x2710>;
					samsung,steps = <0x6>;
					status = "okay";
				};
			};
		};
	};

	fragment@27 {
		target = <0xffffffff>;

		__overlay__ {
			#address-cells = <0x1>;
			#size-cells = <0x0>;
			clock-frequency = <0x61a80>;
			mediatek,use-open-drain;

			usbpd-s2mu106@3C {
				compatible = "s2mu106-usbpd";
				pinctrl-0 = <0x28>;
				pinctrl-names = "default";
				reg = <0x3c>;
				status = "okay";
				usbpd,usbpd_int = <0xffffffff 0x0 0x0>;

				pdic-manager {
					pdic,giveback = <0x0>;
					pdic,max_power = <0x1388>;
					pdic,min_current = <0x1f4>;
					pdic,no_usb_suspend = <0x1>;
					pdic,usb_com_capable = <0x1>;
					pdic_max_current = <0x7d0>;
					pdic_max_voltage = <0x1770>;
					pdic_op_power = <0x9c4>;
					sink,capable_max_voltage = <0x1388>;
					source,max_power = <0x9c4>;
					source,max_voltage = <0x1388>;
					source,min_voltage = <0xfa0>;
				};
			};
		};
	};

	fragment@28 {
		target = <0xffffffff>;

		__overlay__ {

			vib_en_gpio {
				phandle = <0x27>;

				pins_cmd_dat {
					bias-disable;
					output-low;
					pinmux = <0x9600>;
					slew-rate = <0x1>;
				};
			};
		};
	};

	fragment@29 {
		target = <0xffffffff>;

		__overlay__ {

			nfc_ven {
				phandle = <0x29>;

				pins_cmd_dat {
					bias-disable;
					output-high;
					pinmux = <0x9f00>;
				};
			};

			ven_nc {
				phandle = <0x2e>;

				pins_cmd_dat {
					bias-pull-down;
					input-enable;
					pinmux = <0x9f00>;
				};
			};
		};
	};

	fragment@3 {
		target = <0xffffffff>;

		__overlay__ {

			attn-input {
				phandle = <0x7>;

				pins_cmd_dat {
					bias-pull-up;
					pinmux = <0xa00>;
					slew-rate = <0x0>;
				};
			};

			attn-irq {
				phandle = <0x6>;

				pins_cmd_dat {
					bias-pull-up;
					pinmux = <0xa00>;
					slew-rate = <0x0>;
				};
			};

			attn-tsp_ldo_dis_en {
				phandle = <0x9>;

				pins_cmd_dat {
					output-low;
					pinmux = <0xa500>;
					slew-rate = <0x1>;
				};
			};

			attn-tsp_ldo_en {
				phandle = <0x8>;

				pins_cmd_dat {
					output-high;
					pinmux = <0xa500>;
					slew-rate = <0x1>;
				};
			};
		};
	};

	fragment@30 {
		target = <0xffffffff>;

		__overlay__ {

			firm_nc {
				phandle = <0x2f>;

				pins_cmd_dat {
					bias-pull-down;
					input-enable;
					pinmux = <0x9e00>;
				};
			};

			nfc_firm {
				phandle = <0x2a>;

				pins_cmd_dat {
					bias-disable;
					output-low;
					pinmux = <0x9e00>;
				};
			};
		};
	};

	fragment@31 {
		target = <0xffffffff>;

		__overlay__ {

			clk_req_nc {
				phandle = <0x30>;

				pins_cmd_dat {
					bias-pull-down;
					input-enable;
					pinmux = <0x100>;
				};
			};

			nfc_clk_req {
				phandle = <0x2b>;

				pins_cmd_dat {
					bias-pull-down;
					input-enable;
					pinmux = <0x100>;
				};
			};
		};
	};

	fragment@32 {
		target = <0xffffffff>;

		__overlay__ {

			irq_nc {
				phandle = <0x31>;

				pins_cmd_dat {
					bias-pull-down;
					input-enable;
					pinmux = <0x300>;
				};
			};

			nfc_irq {
				phandle = <0x2c>;

				pins_cmd_dat {
					bias-pull-down;
					input-enable;
					pinmux = <0x300>;
				};
			};
		};
	};

	fragment@33 {
		target = <0xffffffff>;

		__overlay__ {

			nfc_check {
				phandle = <0x2d>;

				pins_cmd_dat {
					bias-disable;
					input-enable;
					pinmux = <0x3400>;
				};
			};
		};
	};

	fragment@34 {
		target = <0xffffffff>;

		__overlay__ {
			clock-frequency = <0x61a80>;
			mediatek,use-open-drain;
			status = "ok";

			sec-nfc@27 {
				compatible = "sec-nfc";
				interrupt-parent = <0xffffffff>;
				interrupts = <0x3 0x1 0x3 0x0>;
				nfc_pvdd-supply = <0xffffffff>;
				phandle = <0x99>;
				pinctrl-0 = <0x29 0x2a 0x2b 0x2c 0x2d>;
				pinctrl-1 = <0x2e 0x2f 0x30 0x31>;
				pinctrl-names = "default", "nfc_nc";
				reg = <0x27>;
				sec-nfc,bootloader_ver = <0x6>;
				sec-nfc,check_nfc = <0xffffffff 0x34 0x0>;
				sec-nfc,clk_req-gpio = <0xffffffff 0x1 0x0>;
				sec-nfc,clk_req_wake;
				sec-nfc,firm-gpio = <0xffffffff 0x9e 0x0>;
				sec-nfc,irq-gpio = <0xffffffff 0x3 0x0>;
				sec-nfc,ldo_control;
				sec-nfc,ven-gpio = <0xffffffff 0x9f 0x0>;
			};
		};
	};

	fragment@35 {
		target = <0xffffffff>;

		__overlay__ {

			fg_alert_default {
				phandle = <0x32>;

				pins_cmd_dat {
					bias-disable;
					input-enable;
					pinmux = <0x1a00>;
				};
			};
		};
	};

	fragment@36 {
		target = <0xffffffff>;

		__overlay__ {
			status = "okay";

			s2mu106-fuelgauge@3B {
				compatible = "samsung,s2mu106-fuelgauge";
				fuelgauge,capacity_calculation_type = <0x1c>;
				fuelgauge,capacity_full = <0x1388>;
				fuelgauge,capacity_max = <0x3e8>;
				fuelgauge,capacity_max_margin = <0xc8>;
				fuelgauge,capacity_min = <0x0>;
				fuelgauge,cv_data = <0x9b8 0x33d 0x711 0x969 0x340 0x704 0x917 0x345 0x6e9 0x8e0 0x348 0x6cf 0x886 0x34e 0x6b9 0x838 0x352 0x69a 0x7f6 0x356 0x686 0x79e 0x35b 0x668 0x770 0x35d 0x656 0x72e 0x361 0x63a 0x705 0x363 0x628 0x6d5 0x366 0x618 0x6a7 0x369 0x5fb 0x693 0x369 0x5f5 0x683 0x36b 0x5eb 0x67c 0x36b 0x5e8 0x675 0x36c 0x5e5 0x64f 0x36e 0x5de 0x62c 0x370 0x5cb 0x611 0x371 0x5b7 0x608 0x372 0x5b2 0x5f0 0x373 0x5ab 0x5c5 0x376 0x590 0x597 0x378 0x581 0x574 0x37b 0x567 0x543 0x37e 0x551 0x513 0x380 0x534 0x4f3 0x382 0x523 0x4cf 0x386 0x508 0x4b2 0x388 0x4ef 0x47c 0x38a 0x4db 0x455 0x38d 0x4bd 0x42b 0x38f 0x4a1 0x407 0x392 0x484 0x3f5 0x393 0x474 0x3cf 0x395 0x457 0x3c1 0x397 0x43c 0x399 0x399 0x428 0x37c 0x39b 0x40e 0x377 0x39b 0x3fb 0x35f 0x39d 0x3ec 0x341 0x39f 0x3d0 0x328 0x3a1 0x3b2 0x313 0x3a2 0x396 0x30c 0x3a3 0x388 0x2fc 0x3a4 0x37f 0x2e8 0x3a6 0x360 0x2da 0x3a7 0x34e 0x2cb 0x3a8 0x33c 0x2b5 0x3a9 0x320 0x2a9 0x3aa 0x30f 0x29a 0x3ac 0x2f0 0x28b 0x3ad 0x2df 0x280 0x3ae 0x2c8 0x274 0x3b1 0x2b9 0x26e 0x3b2 0x2a7 0x26a 0x3b3 0x298 0x258 0x3b6 0x286 0x254 0x3b7 0x273 0x24d 0x3b9 0x266 0x248 0x3b9 0x259 0x240 0x3bc 0x23c 0x241 0x3bd 0x229 0x232 0x3be 0x217 0x1ff 0x3c8 0x1fa 0x1f9 0x3c9 0x1e7 0x1ed 0x3cb 0x1d0 0x1ec 0x3cc 0x1b3 0x1e4 0x3cd 0x1a1 0x1e0 0x3cf 0x18e 0x1da 0x3d0 0x17c 0x1d6 0x3d1 0x16c 0x1ce 0x3d1 0x163 0x1c8 0x3d2 0x150 0x1c4 0x3d3 0x149 0x1be 0x3d5 0x12f 0x1b5 0x3d6 0x11a 0x1ad 0x3d8 0xff 0x1a7 0x3d9 0xf2 0x1a6 0x3da 0xe5 0x19e 0x3db 0xd3 0x19b 0x3dc 0xc7 0x195 0x3dd 0xbf 0x18d 0x3de 0xab 0x187 0x3df 0x8c 0x183 0x3e0 0x7e 0x180 0x3e1 0x6b 0x174 0x3e3 0x54 0x16c 0x3e5 0x36 0x164 0x3e6 0x1a 0x164 0x3e6 0xd 0x0 0x3e8 0x0>;
				fuelgauge,fg_log_enable = <0x1>;
				fuelgauge,fuel_alert_soc = <0x1>;
				fuelgauge,fuel_alert_vol = <0xce4>;
				fuelgauge,fuel_int = <0xffffffff 0x1a 0x0>;
				fuelgauge,i_socr_coeff = <0x54>;
				fuelgauge,low_temp_limit = <0x64>;
				fuelgauge,low_voltage_limit_lowtemp = <0xc1c>;
				fuelgauge,ttf_capacity = <0x1112>;
				fuelgauge,type_str = "SDI";
				phandle = <0x9a>;
				pinctrl-0 = <0x32>;
				pinctrl-names = "default";
				reg = <0x3b>;
			};
		};
	};

	fragment@37 {
		target = <0xffffffff>;

		__overlay__ {

			adc_channel@ {
				compatible = "mediatek,adc_channel";
				mediatek,adc_fdd_rf_params_dynamic_custom_ch = <0x0>;
				mediatek,board_id = <0x2>;
				mediatek,temperature0 = <0x4>;
				status = "okay";
			};
		};
	};

	fragment@38 {
		target = <0xffffffff>;

		__overlay__ {
			io-channels = <0xffffffff 0x0>;
		};
	};

	fragment@39 {
		target = <0xffffffff>;

		__overlay__ {
			io-channels = <0xffffffff 0x4>;
		};
	};

	fragment@4 {
		target = <0xffffffff>;

		__overlay__ {
			#address-cells = <0x1>;
			#size-cells = <0x0>;
			clock-frequency = <0x61a80>;
			status = "okay";

			mms_ts@48 {
				compatible = "melfas,mms_ts";
				enable_settings_aot;
				melfas,area-size = <0x85 0x10a 0x155>;
				melfas,event_info = <0x8 0xc>;
				melfas,fod_info = <0xf 0xe 0x1b>;
				melfas,fw_name = "tsp_melfas/mss100_a50.fw";
				melfas,fw_name_old = "tsp_melfas/mss100_a50_p01.fw";
				melfas,irq-gpio = <0xffffffff 0xa 0x0>;
				melfas,max_x_y = <0xfff 0xfff>;
				melfas,node_info = <0xf 0x20 0x0>;
				melfas,project_name = "A505";
				melfas,scl-gpio = <0xffffffff 0x59 0x0>;
				melfas,sda-gpio = <0xffffffff 0x5a 0x0>;
				melfas,support_lpm = "true";
				pinctrl-0 = <0x6>;
				pinctrl-1 = <0x7>;
				pinctrl-2 = <0x8>;
				pinctrl-3 = <0x9>;
				pinctrl-names = "on_state", "off_state", "tsp_ldo_en", "tsp_ldo_dis_en";
				reg = <0x48>;
				support_ear_detect_mode;
				support_fod;
			};
		};
	};

	fragment@40 {
		target = <0xffffffff>;

		__overlay__ {
			io-channels = <0xffffffff 0x0>;
		};
	};

	fragment@41 {
		target = <0xffffffff>;

		__overlay__ {
			mediatek,clkbuf-config = <0x2 0x1 0x1 0x2 0x0 0x0 0x0>;
			mediatek,clkbuf-driving-current = <0x1 0x1 0x1 0x1 0x1 0x1 0x1>;
			mediatek,clkbuf-quantity = <0x7>;
			status = "okay";
		};
	};

	fragment@42 {
		target = <0xffffffff>;

		__overlay__ {
			#address-cells = <0x1>;
			#size-cells = <0x0>;
			clock-frequency = <0x61a80>;
			mediatek,use-open-drain;
		};
	};

	fragment@43 {
		target = <0xffffffff>;

		__overlay__ {

			motor_en {
				phandle = <0x9b>;

				pins_cmd_dat {
					bias-disable;
					output-low;
					pinmux = <0x9600>;
					slew-rate = <0x1>;
				};
			};
		};
	};

	fragment@44 {
		target = <0xffffffff>;

		__overlay__ {

			s2mu106@3D {

				flash_led {
					default_current = <0x32>;
					default_timer = <0x0>;
					factory_current = <0x15e>;
					flash-gpio = <0xffffffff 0x97 0x0>;
					flash_current = <0x5dc>;
					flashlight_current = <0x32 0x4b 0x87 0xaf 0xdc>;
					max_current = <0xc8>;
					movie_current = <0xc8>;
					preflash_current = <0xc8>;
					torch-gpio = <0xffffffff 0x1f 0x0>;
					torch_current = <0x5a>;

					s2mu106-channel1 {
						id = <0x0>;
					};
				};
			};
		};
	};

	fragment@45 {
		target = <0xffffffff>;

		__overlay__ {
			#address-cells = <0x1>;
			#size-cells = <0x0>;
		};
	};

	fragment@46 {
		target = <0xffffffff>;

		__overlay__ {
			#address-cells = <0x1>;
			#size-cells = <0x0>;
			clock-frequency = <0x61a80>;
			mediatek,use-open-drain;
		};
	};

	fragment@47 {
		target = <0xffffffff>;

		__overlay__ {
			#address-cells = <0x1>;
			#size-cells = <0x0>;
			clock-frequency = <0x61a80>;
			mediatek,use-open-drain;
		};
	};

	fragment@48 {
		target = <0xffffffff>;

		__overlay__ {
			#address-cells = <0x1>;
			#size-cells = <0x0>;
			clock-frequency = <0x61a80>;
			mediatek,use-open-drain;
		};
	};

	fragment@49 {
		target = <0xffffffff>;

		__overlay__ {
			GPIO_FDD_BAND_SUPPORT_DETECT_1ST_PIN = <0xffffffff 0x1e 0x0>;
			GPIO_FDD_BAND_SUPPORT_DETECT_2ND_PIN = <0xffffffff 0x4c 0x0>;
			GPIO_FDD_BAND_SUPPORT_DETECT_3RD_PIN = <0xffffffff 0x27 0x0>;
			GPIO_SIM1_HOT_PLUG = <0xffffffff 0x2f 0x0>;
			GPIO_SIM1_SCLK = <0xffffffff 0xac 0x0>;
			GPIO_SIM1_SIO = <0xffffffff 0xae 0x0>;
			GPIO_SIM1_SRST = <0xffffffff 0xad 0x0>;
			GPIO_SIM2_SCLK = <0xffffffff 0x9d 0x0>;
			GPIO_SIM2_SIO = <0xffffffff 0x9b 0x0>;
			GPIO_SIM2_SRST = <0xffffffff 0x9c 0x0>;
		};
	};

	fragment@5 {
		target = <0xffffffff>;

		__overlay__ {
			pinctrl-0 = <0xa>;
			pinctrl-1 = <0xb>;
			pinctrl-2 = <0xc>;
			pinctrl-3 = <0xd>;
			pinctrl-4 = <0xe>;
			pinctrl-5 = <0xf>;
			pinctrl-names = "default", "state_eint_as_int", "state_eint_output0", "state_eint_output1", "state_rst_output0", "state_rst_output1";
			status = "okay";
			tpd-filter-custom-prameters = <0x0 0x0 0x0 0x0 0x0 0x0 0x0 0x0 0x0 0x0 0x0 0x0>;
			tpd-filter-custom-speed = <0x0 0x0 0x0>;
			tpd-filter-enable = <0x1>;
			tpd-filter-pixel-density = <0xa8>;
			tpd-key-dim-local = <0x5a 0x373 0x64 0x28 0xe6 0x373 0x64 0x28 0x172 0x373 0x64 0x28 0x0 0x0 0x0 0x0>;
			tpd-key-local = <0x8b 0xac 0x9e 0x0>;
			tpd-key-num = <0x3>;
			tpd-max-touch-num = <0xa>;
			tpd-resolution = <0x438 0x870>;
			use-tpd-button = <0x0>;
		};
	};

	fragment@50 {
		target = <0xffffffff>;

		__overlay__ {
			gpio_init_default = <0x0 0x0 0x0 0x0 0x1 0x1 0x1 0x1 0x0 0x0 0x0 0x1 0x1 0x1 0x2 0x0 0x0 0x0 0x1 0x0 0x0 0x3 0x0 0x0 0x0 0x1 0x1 0x1 0x4 0x0 0x0 0x0 0x1 0x1 0x0 0x5 0x0 0x0 0x0 0x1 0x0 0x0 0x6 0x0 0x0 0x0 0x1 0x0 0x0 0x7 0x0 0x0 0x0 0x1 0x1 0x0 0x8 0x7 0x0 0x0 0x1 0x0 0x0 0x9 0x0 0x0 0x0 0x0 0x1 0x1 0xa 0x0 0x0 0x0 0x1 0x1 0x1 0xb 0x1 0x0 0x0 0x1 0x0 0x0 0xc 0x0 0x0 0x0 0x1 0x1 0x0 0xd 0x3 0x0 0x0 0x1 0x0 0x0 0xe 0x3 0x1 0x0 0x0 0x0 0x0 0xf 0x3 0x1 0x0 0x0 0x0 0x0 0x10 0x3 0x1 0x0 0x0 0x0 0x0 0x11 0x0 0x0 0x0 0x1 0x1 0x1 0x12 0x0 0x0 0x0 0x1 0x0 0x0 0x13 0x0 0x0 0x0 0x1 0x1 0x1 0x14 0x0 0x1 0x0 0x1 0x0 0x0 0x15 0x0 0x1 0x0 0x0 0x0 0x0 0x16 0x3 0x0 0x0 0x1 0x1 0x0 0x17 0x0 0x1 0x0 0x0 0x0 0x0 0x18 0x3 0x0 0x0 0x1 0x1 0x0 0x19 0x0 0x1 0x0 0x0 0x2 0x0 0x1a 0x0 0x0 0x0 0x1 0x0 0x0 0x1b 0x0 0x1 0x0 0x1 0x0 0x0 0x1c 0x0 0x0 0x0 0x1 0x0 0x0 0x1d 0x0 0x1 0x0 0x1 0x0 0x0 0x1e 0x0 0x0 0x0 0x0 0x0 0x0 0x1f 0x0 0x0 0x0 0x0 0x0 0x0 0x20 0x7 0x1 0x0 0x0 0x0 0x0 0x21 0x7 0x0 0x0 0x1 0x0 0x0 0x22 0x7 0x0 0x0 0x1 0x0 0x0 0x23 0x7 0x0 0x0 0x1 0x0 0x0 0x24 0x2 0x1 0x0 0x0 0x0 0x0 0x25 0x2 0x1 0x0 0x0 0x0 0x0 0x26 0x2 0x1 0x0 0x0 0x0 0x0 0x27 0x0 0x0 0x0 0x0 0x0 0x0 0x28 0x2 0x0 0x0 0x1 0x0 0x0 0x29 0x0 0x0 0x0 0x1 0x0 0x1 0x2a 0x0 0x0 0x0 0x1 0x0 0x1 0x2b 0x0 0x0 0x0 0x1 0x1 0x0 0x2c 0x1 0x0 0x0 0x1 0x0 0x0 0x2d 0x0 0x1 0x0 0x0 0x2 0x0 0x2e 0x0 0x0 0x0 0x1 0x0 0x0 0x2f 0x1 0x0 0x0 0x1 0x1 0x0 0x30 0x1 0x0 0x0 0x1 0x1 0x1 0x31 0x1 0x0 0x0 0x1 0x1 0x1 0x32 0x1 0x0 0x0 0x1 0x1 0x1 0x33 0x1 0x0 0x0 0x1 0x1 0x1 0x34 0x0 0x0 0x0 0x1 0x0 0x0 0x35 0x0 0x0 0x0 0x1 0x0 0x0 0x36 0x0 0x0 0x0 0x1 0x0 0x0 0x37 0x1 0x0 0x0 0x1 0x0 0x0 0x38 0x1 0x0 0x0 0x1 0x0 0x0 0x39 0x1 0x0 0x0 0x1 0x0 0x0 0x3a 0x0 0x0 0x0 0x1 0x0 0x0 0x3b 0x1 0x0 0x0 0x1 0x0 0x0 0x3c 0x1 0x0 0x0 0x1 0x0 0x0 0x3d 0x1 0x0 0x0 0x1 0x0 0x0 0x3e 0x1 0x0 0x0 0x1 0x0 0x0 0x3f 0x1 0x0 0x0 0x1 0x0 0x0 0x40 0x1 0x0 0x0 0x1 0x0 0x0 0x41 0x1 0x0 0x0 0x1 0x0 0x0 0x42 0x1 0x0 0x0 0x1 0x0 0x0 0x43 0x1 0x0 0x0 0x1 0x0 0x0 0x44 0x1 0x0 0x0 0x1 0x0 0x0 0x45 0x0 0x0 0x0 0x0 0x0 0x0 0x46 0x1 0x0 0x0 0x1 0x0 0x0 0x47 0x1 0x0 0x0 0x1 0x0 0x0 0x48 0x1 0x0 0x0 0x1 0x0 0x0 0x49 0x1 0x0 0x0 0x1 0x0 0x0 0x4a 0x1 0x0 0x0 0x1 0x0 0x0 0x4b 0x1 0x0 0x0 0x1 0x0 0x0 0x4c 0x0 0x0 0x0 0x0 0x0 0x0 0x4d 0x1 0x0 0x0 0x1 0x0 0x0 0x4e 0x0 0x0 0x0 0x1 0x0 0x0 0x4f 0x0 0x0 0x0 0x0 0x0 0x0 0x50 0x0 0x0 0x0 0x1 0x0 0x0 0x51 0x1 0x0 0x0 0x1 0x1 0x1 0x52 0x1 0x0 0x0 0x1 0x1 0x1 0x53 0x1 0x0 0x0 0x1 0x1 0x1 0x54 0x1 0x0 0x0 0x1 0x1 0x1 0x55 0x2 0x0 0x0 0x1 0x0 0x0 0x56 0x2 0x1 0x0 0x0 0x0 0x0 0x57 0x2 0x1 0x0 0x0 0x0 0x0 0x58 0x2 0x1 0x0 0x0 0x0 0x0 0x59 0x1 0x0 0x0 0x1 0x1 0x1 0x5a 0x1 0x0 0x0 0x1 0x1 0x1 0x5b 0x0 0x1 0x0 0x1 0x0 0x0 0x5c 0x0 0x0 0x0 0x0 0x2 0x0 0x5d 0x1 0x0 0x0 0x1 0x1 0x0 0x5e 0x1 0x0 0x0 0x1 0x1 0x0 0x5f 0x1 0x0 0x0 0x1 0x1 0x0 0x60 0x1 0x1 0x0 0x0 0x0 0x0 0x61 0x0 0x0 0x0 0x1 0x0 0x0 0x62 0x0 0x1 0x0 0x1 0x0 0x0 0x63 0x1 0x1 0x0 0x0 0x0 0x0 0x64 0x1 0x1 0x0 0x0 0x0 0x0 0x65 0x0 0x1 0x0 0x1 0x0 0x0 0x66 0x0 0x1 0x0 0x1 0x0 0x0 0x67 0x1 0x0 0x0 0x1 0x1 0x1 0x68 0x1 0x0 0x0 0x1 0x1 0x1 0x69 0x1 0x0 0x0 0x1 0x1 0x1 0x6a 0x1 0x0 0x0 0x1 0x1 0x1 0x6b 0x0 0x0 0x0 0x1 0x0 0x0 0x6c 0x1 0x1 0x0 0x0 0x0 0x0 0x6d 0x0 0x1 0x0 0x1 0x0 0x0 0x6e 0x0 0x0 0x0 0x1 0x0 0x0 0x6f 0x1 0x1 0x0 0x0 0x0 0x0 0x70 0x0 0x0 0x0 0x1 0x0 0x0 0x71 0x0 0x1 0x0 0x1 0x0 0x0 0x72 0x1 0x1 0x0 0x1 0x0 0x1 0x73 0x0 0x1 0x0 0x1 0x0 0x0 0x74 0x1 0x1 0x0 0x1 0x0 0x1 0x75 0x0 0x0 0x0 0x1 0x0 0x0 0x76 0x0 0x0 0x0 0x1 0x0 0x0 0x77 0x0 0x0 0x0 0x1 0x0 0x0 0x78 0x0 0x1 0x0 0x1 0x0 0x0 0x79 0x0 0x1 0x0 0x1 0x0 0x0 0x7a 0x1 0x0 0x0 0x1 0x1 0x1 0x7b 0x1 0x0 0x0 0x1 0x1 0x1 0x7c 0x1 0x1 0x0 0x0 0x0 0x1 0x7d 0x1 0x0 0x0 0x1 0x1 0x1 0x7e 0x1 0x0 0x0 0x1 0x1 0x1 0x7f 0x1 0x0 0x0 0x1 0x1 0x1 0x80 0x1 0x0 0x0 0x1 0x1 0x1 0x81 0x1 0x0 0x0 0x1 0x1 0x1 0x82 0x1 0x0 0x0 0x1 0x1 0x1 0x83 0x1 0x1 0x0 0x0 0x0 0x1 0x84 0x1 0x0 0x0 0x1 0x1 0x1 0x85 0x1 0x1 0x0 0x0 0x0 0x1 0x86 0x1 0x0 0x0 0x1 0x0 0x1 0x87 0x1 0x1 0x0 0x0 0x0 0x0 0x88 0x1 0x1 0x0 0x0 0x0 0x0 0x89 0x1 0x1 0x0 0x0 0x0 0x0 0x8a 0x1 0x1 0x0 0x0 0x0 0x0 0x8b 0x1 0x1 0x0 0x0 0x0 0x0 0x8c 0x1 0x0 0x0 0x1 0x0 0x0 0x8d 0x1 0x0 0x0 0x1 0x0 0x0 0x8e 0x1 0x0 0x0 0x1 0x0 0x0 0x8f 0x1 0x0 0x0 0x1 0x0 0x0 0x90 0x1 0x0 0x0 0x1 0x0 0x0 0x91 0x1 0x1 0x0 0x0 0x0 0x0 0x92 0x1 0x1 0x0 0x0 0x0 0x0 0x93 0x1 0x1 0x0 0x0 0x0 0x0 0x94 0x1 0x1 0x0 0x0 0x0 0x0 0x95 0x1 0x1 0x0 0x0 0x0 0x0 0x96 0x0 0x0 0x0 0x1 0x0 0x0 0x97 0x0 0x0 0x0 0x1 0x0 0x0 0x98 0x0 0x1 0x1 0x1 0x0 0x0 0x99 0x0 0x1 0x0 0x0 0x2 0x0 0x9a 0x1 0x1 0x0 0x0 0x0 0x0 0x9b 0x1 0x0 0x0 0x1 0x1 0x0 0x9c 0x1 0x1 0x0 0x0 0x0 0x0 0x9d 0x1 0x1 0x0 0x0 0x0 0x0 0x9e 0x0 0x0 0x0 0x1 0x0 0x0 0x9f 0x0 0x1 0x0 0x0 0x0 0x0 0xa0 0x0 0x0 0x0 0x1 0x0 0x0 0xa1 0x1 0x0 0x0 0x1 0x1 0x1 0xa2 0x1 0x0 0x0 0x1 0x1 0x1 0xa3 0x1 0x0 0x0 0x1 0x1 0x1 0xa4 0x1 0x0 0x0 0x1 0x1 0x1 0xa5 0x0 0x1 0x0 0x1 0x0 0x0 0xa6 0x0 0x1 0x0 0x1 0x0 0x0 0xa7 0x1 0x0 0x0 0x1 0x0 0x0 0xa8 0x1 0x0 0x0 0x1 0x0 0x0 0xa9 0x0 0x0 0x0 0x0 0x2 0x0 0xaa 0x1 0x0 0x0 0x1 0x1 0x1 0xab 0x1 0x1 0x0 0x0 0x0 0x1 0xac 0x1 0x1 0x0 0x0 0x0 0x0 0xad 0x1 0x1 0x0 0x0 0x0 0x0 0xae 0x1 0x0 0x0 0x1 0x1 0x0 0xaf 0x2 0x0 0x1 0x1 0x1 0x1 0xb0 0x2 0x0 0x1 0x1 0x1 0x1 0xb1 0x0 0x0 0x0 0x1 0x0 0x0 0xb2 0x0 0x1 0x1 0x0 0x0 0x0 0xb3 0x0 0x0 0x0 0x1 0x0 0x0 0xb4 0x0 0x0 0x0 0x1 0x0 0x0 0xb5 0x0 0x0 0x0 0x1 0x0 0x0 0xb6 0x0 0x0 0x0 0x1 0x0 0x0 0xb7 0x0 0x0 0x0 0x1 0x0 0x0 0xb8 0x0 0x0 0x0 0x1 0x0 0x0 0xb9 0x0 0x0 0x0 0x1 0x0 0x0 0xba 0x0 0x0 0x0 0x1 0x0 0x0>;
		};
	};

	fragment@51 {
		target = <0xffffffff>;

		__overlay__ {
			gpio_init_default_samsung = <0x6 0x0 0x0 0x0 0x1 0x0 0x0 0x12 0x0 0x0 0x0 0x1 0x0 0x0 0x14 0x0 0x1 0x0 0x1 0x0 0x0 0x19 0x0 0x1 0x0 0x0 0x2 0x0 0x1b 0x0 0x1 0x0 0x1 0x0 0x0 0x1c 0x0 0x0 0x0 0x1 0x0 0x0 0x1d 0x0 0x1 0x0 0x1 0x0 0x0 0x1e 0x0 0x0 0x0 0x0 0x0 0x0 0x27 0x0 0x0 0x0 0x0 0x0 0x0 0x4c 0x0 0x0 0x0 0x0 0x0 0x0 0x2e 0x0 0x0 0x0 0x1 0x0 0x0 0x4e 0x0 0x0 0x0 0x1 0x0 0x0 0x2c 0x1 0x0 0x0 0x1 0x0 0x0 0x2d 0x0 0x1 0x0 0x0 0x2 0x0 0x36 0x0 0x0 0x0 0x1 0x0 0x0 0x3a 0x0 0x0 0x0 0x1 0x0 0x0 0x5b 0x0 0x1 0x0 0x1 0x0 0x0 0x5c 0x0 0x0 0x0 0x0 0x2 0x0 0x61 0x0 0x0 0x0 0x1 0x0 0x0 0x62 0x0 0x1 0x0 0x1 0x0 0x0 0x65 0x0 0x1 0x0 0x1 0x0 0x0 0x66 0x0 0x1 0x0 0x1 0x0 0x0 0x6b 0x0 0x0 0x0 0x1 0x0 0x0 0x6d 0x0 0x1 0x0 0x1 0x0 0x0 0x6e 0x0 0x0 0x0 0x1 0x0 0x0 0x70 0x0 0x0 0x0 0x1 0x0 0x0 0x71 0x0 0x1 0x0 0x1 0x0 0x0 0x72 0x1 0x1 0x0 0x1 0x0 0x1 0x73 0x0 0x1 0x0 0x1 0x0 0x0 0x74 0x1 0x1 0x0 0x1 0x0 0x1 0x78 0x0 0x1 0x0 0x1 0x0 0x0 0x79 0x0 0x1 0x0 0x1 0x0 0x0 0x99 0x0 0x1 0x0 0x0 0x2 0x0 0xa0 0x0 0x0 0x0 0x1 0x0 0x0 0xa9 0x0 0x0 0x0 0x0 0x2 0x0 0xb3 0x0 0x0 0x0 0x1 0x0 0x0>;
		};
	};

	fragment@52 {
		target = <0xffffffff>;

		__overlay__ {
			interrupt-parent = <0xffffffff>;
			interrupts = <0xa 0x8 0xa 0x0>;
			status = "okay";
		};
	};

	fragment@53 {
		target = <0xffffffff>;

		__overlay__ {
			force_mode = "SYSRST";
			interrupt-parent = <0xffffffff>;
			mode = "RST";
			status = "okay";
		};
	};

	fragment@54 {
		target = <0xffffffff>;

		__overlay__ {
			interrupt-parent = <0xffffffff>;
			interrupts = <0x2c 0x1 0x2c 0x1>;
			status = "okay";
		};
	};

	fragment@55 {
		target = <0xffffffff>;

		__overlay__ {
			interrupt-parent = <0xffffffff>;
			interrupts = <0x90 0x4 0xb4 0x0>;
			status = "okay";
		};
	};

	fragment@56 {
		target = <0xffffffff>;

		__overlay__ {
			compatible = "mediatek,md1_sim1_hot_plug_eint-eint";
			debounce = <0x0 0x2710>;
			dedicated = <0x0 0x0>;
			interrupts = <0x0 0x4>;
			sockettype = <0x0 0x0>;
			src_pin = <0x0 0x1>;
			status = "okay";
		};
	};

	fragment@57 {
		target = <0xffffffff>;

		__overlay__ {
			regulator-default-on = <0x1>;
			regulator-name = "vcama1";
			status = "okay";
		};
	};

	fragment@58 {
		target = <0xffffffff>;

		__overlay__ {
			regulator-default-on = <0x1>;
			regulator-name = "vcama2";
			status = "okay";
		};
	};

	fragment@59 {
		target = <0xffffffff>;

		__overlay__ {
			regulator-default-on = <0x1>;
			regulator-name = "vsim1";
			status = "okay";
		};
	};

	fragment@6 {
		target = <0xffffffff>;

		__overlay__ {

			eint0default {
				phandle = <0xa>;
			};

			eint@0 {
				phandle = <0xb>;

				pins_cmd_dat {
					bias-disable;
					pinmux = <0x100>;
					slew-rate = <0x0>;
				};
			};

			eintoutput0 {
				phandle = <0xc>;

				pins_cmd_dat {
					output-low;
					pinmux = <0x100>;
					slew-rate = <0x1>;
				};
			};

			eintoutput1 {
				phandle = <0xd>;

				pins_cmd_dat {
					output-high;
					pinmux = <0x100>;
					slew-rate = <0x1>;
				};
			};

			rstoutput0 {
				phandle = <0xe>;

				pins_cmd_dat {
					output-low;
					pinmux = <0x1700>;
					slew-rate = <0x1>;
				};
			};

			rstoutput1 {
				phandle = <0xf>;

				pins_cmd_dat {
					output-high;
					pinmux = <0x1700>;
					slew-rate = <0x1>;
				};
			};
		};
	};

	fragment@60 {
		target = <0xffffffff>;

		__overlay__ {
			regulator-default-on = <0x1>;
			regulator-name = "vsim2";
			status = "okay";
		};
	};

	fragment@61 {
		target = <0xffffffff>;

		__overlay__ {
			regulator-default-on = <0x1>;
			regulator-name = "vcamd";
			status = "okay";
		};
	};

	fragment@62 {
		target = <0xffffffff>;

		__overlay__ {
			regulator-default-on = <0x1>;
			regulator-name = "vcamio";
			status = "okay";
		};
	};

	fragment@63 {
		target = <0xffffffff>;

		__overlay__ {
			regulator-default-on = <0x1>;
			regulator-name = "vldo28";
			status = "okay";
		};
	};

	fragment@64 {
		target = <0xffffffff>;

		__overlay__ {
			status = "okay";
			vcama-supply = <0xffffffff>;
			vcama_main3-supply = <0xffffffff>;
			vcamaf-supply = <0xffffffff>;
			vcamd_main2-supply = <0xffffffff>;
		};
	};

	fragment@65 {
		target = <0xffffffff>;

		__overlay__ {
			status = "okay";
		};
	};

	fragment@66 {
		target = <0xffffffff>;

		__overlay__ {
			mediatek,kpd-hw-dl-key2 = <0x8>;
			mediatek,kpd-hw-factory-key = <0x1>;
			mediatek,kpd-hw-init-map = <0x0 0x73 0x0 0x0 0x0 0x0 0x0 0x0 0x0 0x0 0x0 0x0 0x0 0x0 0x0 0x0 0x0 0x0 0x0 0x0 0x0 0x0 0x0 0x0 0x0 0x0 0x0 0x0 0x0 0x0 0x0 0x0 0x0 0x0 0x0 0x0 0x0 0x0 0x0 0x0 0x0 0x0 0x0 0x0 0x0 0x0 0x0 0x0 0x0 0x0 0x0 0x0 0x0 0x0 0x0 0x0 0x0 0x0 0x0 0x0 0x0 0x0 0x0 0x0 0x0 0x0 0x0 0x0 0x0 0x0 0x0 0x0>;
			mediatek,kpd-hw-map-num = <0x48>;
			mediatek,kpd-hw-pwrkey = <0x8>;
			mediatek,kpd-hw-recovery-key = <0x11>;
			mediatek,kpd-hw-rstkey = <0x11>;
			mediatek,kpd-key-debounce = <0x400>;
			mediatek,kpd-pwkey-gpio-din = <0x0>;
			mediatek,kpd-pwrkey-eint-gpio = <0x0>;
			mediatek,kpd-sw-pwrkey = <0x74>;
			mediatek,kpd-sw-rstkey = <0x72>;
			mediatek,kpd-use-extend-type = <0x0>;
			status = "okay";
		};
	};

	fragment@67 {
		target = <0xffffffff>;

		__overlay__ {

			camdefault {
				phandle = <0x35>;
			};

			camera0_mclk_2mA@gpio99 {
				phandle = <0x45>;

				pins_cmd_dat {
					drive-strength = <0x0>;
					pinmux = <0x6301>;
				};
			};

			camera0_mclk_4mA@gpio99 {
				phandle = <0x46>;

				pins_cmd_dat {
					drive-strength = <0x1>;
					pinmux = <0x6301>;
				};
			};

			camera0_mclk_6mA@gpio99 {
				phandle = <0x47>;

				pins_cmd_dat {
					drive-strength = <0x2>;
					pinmux = <0x6301>;
				};
			};

			camera0_mclk_8mA@gpio99 {
				phandle = <0x48>;

				pins_cmd_dat {
					drive-strength = <0x3>;
					pinmux = <0x6301>;
				};
			};

			camera0_mclk_gpio_mode@gpio99 {
				phandle = <0x44>;

				pins_cmd_dat {
					drive-strength = <0x1>;
					pinmux = <0x6300>;
				};
			};

			camera0_rst_output_high@gpio102 {
				phandle = <0x37>;

				pins_cmd_dat {
					output-high;
					pinmux = <0x6600>;
				};
			};

			camera0_rst_output_low@gpio102 {
				phandle = <0x36>;

				pins_cmd_dat {
					output-low;
					pinmux = <0x6600>;
				};
			};

			camera1_mclk_2mA@gpio111 {
				phandle = <0x4a>;

				pins_cmd_dat {
					drive-strength = <0x0>;
					pinmux = <0x6f01>;
				};
			};

			camera1_mclk_4mA@gpio111 {
				phandle = <0x4b>;

				pins_cmd_dat {
					drive-strength = <0x1>;
					pinmux = <0x6f01>;
				};
			};

			camera1_mclk_6mA@gpio111 {
				phandle = <0x4c>;

				pins_cmd_dat {
					drive-strength = <0x2>;
					pinmux = <0x6f01>;
				};
			};

			camera1_mclk_8mA@gpio111 {
				phandle = <0x4d>;

				pins_cmd_dat {
					drive-strength = <0x3>;
					pinmux = <0x6f01>;
				};
			};

			camera1_mclk_gpio_mode@gpio111 {
				phandle = <0x49>;

				pins_cmd_dat {
					drive-strength = <0x1>;
					pinmux = <0x6f00>;
				};
			};

			camera1_rst_output_high@gpio20 {
				phandle = <0x39>;

				pins_cmd_dat {
					output-high;
					pinmux = <0x1400>;
				};
			};

			camera1_rst_output_low@gpio20 {
				phandle = <0x38>;

				pins_cmd_dat {
					output-low;
					pinmux = <0x1400>;
				};
			};

			camera2_mclk_2mA@gpio108 {
				phandle = <0x4f>;

				pins_cmd_dat {
					drive-strength = <0x0>;
					pinmux = <0x6c01>;
				};
			};

			camera2_mclk_4mA@gpio108 {
				phandle = <0x50>;

				pins_cmd_dat {
					drive-strength = <0x1>;
					pinmux = <0x6c01>;
				};
			};

			camera2_mclk_6mA@gpio108 {
				phandle = <0x51>;

				pins_cmd_dat {
					drive-strength = <0x2>;
					pinmux = <0x6c01>;
				};
			};

			camera2_mclk_8mA@gpio108 {
				phandle = <0x52>;

				pins_cmd_dat {
					drive-strength = <0x3>;
					pinmux = <0x6c01>;
				};
			};

			camera2_mclk_gpio_mode@gpio108 {
				phandle = <0x4e>;

				pins_cmd_dat {
					drive-strength = <0x1>;
					pinmux = <0x6c00>;
				};
			};

			camera2_rst_output_high@gpio27 {
				phandle = <0x3b>;

				pins_cmd_dat {
					output-high;
					pinmux = <0x1b00>;
				};
			};

			camera2_rst_output_low@gpio27 {
				phandle = <0x3a>;

				pins_cmd_dat {
					output-low;
					pinmux = <0x1b00>;
				};
			};

			camera3_mclk_2mA@gpio100 {
				phandle = <0x54>;

				pins_cmd_dat {
					drive-strength = <0x0>;
					pinmux = <0x6401>;
				};
			};

			camera3_mclk_4mA@gpio100 {
				phandle = <0x55>;

				pins_cmd_dat {
					drive-strength = <0x1>;
					pinmux = <0x6401>;
				};
			};

			camera3_mclk_6mA@gpio100 {
				phandle = <0x56>;

				pins_cmd_dat {
					drive-strength = <0x2>;
					pinmux = <0x6401>;
				};
			};

			camera3_mclk_8mA@gpio100 {
				phandle = <0x57>;

				pins_cmd_dat {
					drive-strength = <0x3>;
					pinmux = <0x6401>;
				};
			};

			camera3_mclk_gpio_mode@gpio100 {
				phandle = <0x53>;

				pins_cmd_dat {
					drive-strength = <0x1>;
					pinmux = <0x6400>;
				};
			};

			camera3_rst_output_high@gpio101 {
				phandle = <0x3d>;

				pins_cmd_dat {
					output-high;
					pinmux = <0x6500>;
				};
			};

			camera3_rst_output_low@gpio101 {
				phandle = <0x3c>;

				pins_cmd_dat {
					output-low;
					pinmux = <0x6500>;
				};
			};

			camera4_mclk_2mA@gpio108 {
				phandle = <0x59>;

				pins_cmd_dat {
					drive-strength = <0x0>;
					pinmux = <0x6c01>;
				};
			};

			camera4_mclk_4mA@gpio108 {
				phandle = <0x5a>;

				pins_cmd_dat {
					drive-strength = <0x1>;
					pinmux = <0x6c01>;
				};
			};

			camera4_mclk_6mA@gpio108 {
				phandle = <0x5b>;

				pins_cmd_dat {
					drive-strength = <0x2>;
					pinmux = <0x6c01>;
				};
			};

			camera4_mclk_8mA@gpio108 {
				phandle = <0x5c>;

				pins_cmd_dat {
					drive-strength = <0x3>;
					pinmux = <0x6c01>;
				};
			};

			camera4_mclk_gpio_mode@gpio108 {
				phandle = <0x58>;

				pins_cmd_dat {
					drive-strength = <0x1>;
					pinmux = <0x6c00>;
				};
			};

			camera4_rst_output_high@gpio109 {
				phandle = <0x3f>;

				pins_cmd_dat {
					output-high;
					pinmux = <0x6d00>;
				};
			};

			camera4_rst_output_low@gpio109 {
				phandle = <0x3e>;

				pins_cmd_dat {
					output-low;
					pinmux = <0x6d00>;
				};
			};

			camera4_vcama_output_high@gpio98 {
				phandle = <0x40>;

				pins_cmd_dat {
					output-high;
					pinmux = <0x6200>;
				};
			};

			camera4_vcama_output_low@gpio98 {
				phandle = <0x41>;

				pins_cmd_dat {
					output-low;
					pinmux = <0x6200>;
				};
			};

			camera4_vcamd_output_high@gpio29 {
				phandle = <0x42>;

				pins_cmd_dat {
					output-high;
					pinmux = <0x1d00>;
				};
			};

			camera4_vcamd_output_low@gpio29 {
				phandle = <0x43>;

				pins_cmd_dat {
					output-low;
					pinmux = <0x1d00>;
				};
			};

			camera_main_four_i2c_scl_off@gpio24 {
				phandle = <0x78>;

				pins_cmd_dat {
					bias-pull-down;
					pinmux = <0x1800>;
				};
			};

			camera_main_four_i2c_scl_on@gpio24 {
				phandle = <0x76>;

				pins_cmd_dat {
					bias-pull-up;
					pinmux = <0x1803>;
				};
			};

			camera_main_four_i2c_sda_off@gpio22 {
				phandle = <0x79>;

				pins_cmd_dat {
					bias-pull-down;
					pinmux = <0x1600>;
				};
			};

			camera_main_four_i2c_sda_on@gpio22 {
				phandle = <0x77>;

				pins_cmd_dat {
					bias-pull-up;
					pinmux = <0x1603>;
				};
			};

			camera_main_i2c_scl_off@gpio105 {
				phandle = <0x6c>;

				pins_cmd_dat {
					bias-pull-down;
					pinmux = <0x6900>;
				};
			};

			camera_main_i2c_scl_on@gpio105 {
				phandle = <0x6a>;

				pins_cmd_dat {
					bias-pull-up;
					pinmux = <0x6901>;
				};
			};

			camera_main_i2c_sda_off@gpio106 {
				phandle = <0x6d>;

				pins_cmd_dat {
					bias-pull-down;
					pinmux = <0x6a00>;
				};
			};

			camera_main_i2c_sda_on@gpio106 {
				phandle = <0x6b>;

				pins_cmd_dat {
					bias-pull-up;
					pinmux = <0x6a01>;
				};
			};

			camera_main_three_i2c_scl_off@gpio24 {
				phandle = <0x74>;

				pins_cmd_dat {
					bias-pull-down;
					pinmux = <0x1800>;
				};
			};

			camera_main_three_i2c_scl_on@gpio24 {
				phandle = <0x72>;

				pins_cmd_dat {
					bias-pull-up;
					pinmux = <0x1803>;
				};
			};

			camera_main_three_i2c_sda_off@gpio22 {
				phandle = <0x75>;

				pins_cmd_dat {
					bias-pull-down;
					pinmux = <0x1600>;
				};
			};

			camera_main_three_i2c_sda_on@gpio22 {
				phandle = <0x73>;

				pins_cmd_dat {
					bias-pull-up;
					pinmux = <0x1603>;
				};
			};

			camera_main_two_i2c_scl_off@gpio24 {
				phandle = <0x70>;

				pins_cmd_dat {
					bias-pull-down;
					pinmux = <0x1800>;
				};
			};

			camera_main_two_i2c_scl_on@gpio24 {
				phandle = <0x6e>;

				pins_cmd_dat {
					bias-pull-up;
					pinmux = <0x1803>;
				};
			};

			camera_main_two_i2c_sda_off@gpio22 {
				phandle = <0x71>;

				pins_cmd_dat {
					bias-pull-down;
					pinmux = <0x1600>;
				};
			};

			camera_main_two_i2c_sda_on@gpio22 {
				phandle = <0x6f>;

				pins_cmd_dat {
					bias-pull-up;
					pinmux = <0x1603>;
				};
			};

			camera_mipi_sw_sel_high@gpio91 {
				phandle = <0x5d>;

				pins_cmd_dat {
					output-high;
					pinmux = <0x5b00>;
				};
			};

			camera_mipi_sw_sel_low@gpio91 {
				phandle = <0x5e>;

				pins_cmd_dat {
					output-low;
					pinmux = <0x5b00>;
				};
			};

			camera_sub_i2c_scl_off@gpio103 {
				phandle = <0x68>;

				pins_cmd_dat {
					bias-pull-down;
					pinmux = <0x6700>;
				};
			};

			camera_sub_i2c_scl_on@gpio103 {
				phandle = <0x66>;

				pins_cmd_dat {
					bias-pull-up;
					pinmux = <0x6701>;
				};
			};

			camera_sub_i2c_sda_off@gpio104 {
				phandle = <0x69>;

				pins_cmd_dat {
					bias-pull-down;
					pinmux = <0x6800>;
				};
			};

			camera_sub_i2c_sda_on@gpio104 {
				phandle = <0x67>;

				pins_cmd_dat {
					bias-pull-up;
					pinmux = <0x6801>;
				};
			};
		};
	};

	fragment@68 {
		target = <0xffffffff>;

		__overlay__ {
			cam0_vcama-supply = <0x5f>;
			cam0_vcamaf-supply = <0xffffffff>;
			cam0_vcamd-supply = <0x60>;
			cam0_vcamio-supply = <0x61>;
			cam1_vcama-supply = <0x62>;
			cam1_vcamd-supply = <0x63>;
			cam1_vcamio-supply = <0x61>;
			cam2_vcama-supply = <0xffffffff>;
			cam2_vcamd-supply = <0x64>;
			cam2_vcamio-supply = <0x61>;
			cam3_vcama-supply = <0x65>;
			cam3_vcamd-supply = <0xffffffff>;
			cam3_vcamio-supply = <0x61>;
			cam4_vcamio-supply = <0x61>;
			pinctrl-0 = <0x35>;
			pinctrl-1 = <0x36>;
			pinctrl-10 = <0x3f>;
			pinctrl-11 = <0x40>;
			pinctrl-12 = <0x41>;
			pinctrl-13 = <0x42>;
			pinctrl-14 = <0x43>;
			pinctrl-15 = <0x44>;
			pinctrl-16 = <0x45>;
			pinctrl-17 = <0x46>;
			pinctrl-18 = <0x47>;
			pinctrl-19 = <0x48>;
			pinctrl-2 = <0x37>;
			pinctrl-20 = <0x49>;
			pinctrl-21 = <0x4a>;
			pinctrl-22 = <0x4b>;
			pinctrl-23 = <0x4c>;
			pinctrl-24 = <0x4d>;
			pinctrl-25 = <0x4e>;
			pinctrl-26 = <0x4f>;
			pinctrl-27 = <0x50>;
			pinctrl-28 = <0x51>;
			pinctrl-29 = <0x52>;
			pinctrl-3 = <0x38>;
			pinctrl-30 = <0x53>;
			pinctrl-31 = <0x54>;
			pinctrl-32 = <0x55>;
			pinctrl-33 = <0x56>;
			pinctrl-34 = <0x57>;
			pinctrl-35 = <0x58>;
			pinctrl-36 = <0x59>;
			pinctrl-37 = <0x5a>;
			pinctrl-38 = <0x5b>;
			pinctrl-39 = <0x5c>;
			pinctrl-4 = <0x39>;
			pinctrl-40 = <0x5d>;
			pinctrl-41 = <0x5e>;
			pinctrl-5 = <0x3a>;
			pinctrl-6 = <0x3b>;
			pinctrl-7 = <0x3c>;
			pinctrl-8 = <0x3d>;
			pinctrl-9 = <0x3e>;
			pinctrl-names = "default", "cam0_rst0", "cam0_rst1", "cam1_rst0", "cam1_rst1", "cam2_rst0", "cam2_rst1", "cam3_rst0", "cam3_rst1", "cam4_rst0", "cam4_rst1", "cam4_vcama_on", "cam4_vcama_off", "cam4_vcamd_on", "cam4_vcamd_off", "cam0_mclk_off", "cam0_mclk_2mA", "cam0_mclk_4mA", "cam0_mclk_6mA", "cam0_mclk_8mA", "cam1_mclk_off", "cam1_mclk_2mA", "cam1_mclk_4mA", "cam1_mclk_6mA", "cam1_mclk_8mA", "cam2_mclk_off", "cam2_mclk_2mA", "cam2_mclk_4mA", "cam2_mclk_6mA", "cam2_mclk_8mA", "cam3_mclk_off", "cam3_mclk_2mA", "cam3_mclk_4mA", "cam3_mclk_6mA", "cam3_mclk_8mA", "cam4_mclk_off", "cam4_mclk_2mA", "cam4_mclk_4mA", "cam4_mclk_6mA", "cam4_mclk_8mA", "cam_mipi_switch_sel_1", "cam_mipi_switch_sel_0";
			status = "okay";

			vendor {
				front_sensor_id = <0x79>;
				max_camera_num = <0x5>;
				max_supported_camera = <0x6>;
				rear2_sensor_id = <0xd2>;
				rear3_sensor_id = <0xd3>;
				rear4_sensor_id = <0xd2>;
				rear_sensor_id = <0x78>;
				supported_cameraId = <0x0 0x1 0x17 0x32 0x34 0x36>;
				use_module_check;

				camera_info0 {
					cal_memory = <0x2>;
					companion = <0x0>;
					core_voltage = <0x0>;
					dual_open = <0x0>;
					includes_sub = <0x4>;
					isp = <0x0>;
					ois = <0x0>;
					position = <0x0>;
					read_version = <0x0>;
					upgrade = <0x0>;
					valid = <0x1>;
				};

				camera_info1 {
					cal_memory = <0x2>;
					companion = <0x0>;
					core_voltage = <0x0>;
					dual_open = <0x0>;
					isp = <0x0>;
					ois = <0x0>;
					position = <0x1>;
					read_version = <0x0>;
					upgrade = <0x0>;
					valid = <0x1>;
				};

				camera_info2 {
					cal_memory = <0x2>;
					companion = <0x0>;
					core_voltage = <0x0>;
					dual_open = <0x0>;
					isp = <0x0>;
					ois = <0x0>;
					position = <0x2>;
					read_version = <0x0>;
					upgrade = <0x0>;
					valid = <0x1>;
				};

				camera_info3 {
					cal_memory = <0x2>;
					companion = <0x0>;
					core_voltage = <0x0>;
					dual_open = <0x1>;
					isp = <0x0>;
					ois = <0x0>;
					position = <0x4>;
					read_version = <0x0>;
					upgrade = <0x0>;
					valid = <0x1>;
				};

				camera_info4 {
					cal_memory = <0x2>;
					companion = <0x0>;
					core_voltage = <0x0>;
					dual_open = <0x0>;
					isp = <0x0>;
					ois = <0x0>;
					position = <0x6>;
					read_version = <0x0>;
					upgrade = <0x0>;
					valid = <0x1>;
				};
			};
		};
	};

	fragment@69 {
		target = <0xffffffff>;

		__overlay__ {
			status = "okay";
			vcamaf-supply = <0xffffffff>;
		};
	};

	fragment@7 {
		target = <0xffffffff>;

		__overlay__ {
			clock-frequency = <0x61a80>;

			mtk-usb@60 {
				compatible = "mediatek,mtk-usb";
				reg = <0x60>;
				status = "okay";
			};
		};
	};

	fragment@70 {
		target = <0xffffffff>;

		__overlay__ {
			#address-cells = <0x1>;
			#size-cells = <0x0>;
			clock-frequency = <0x61a80>;
			id = <0x13>;
			mediatek,use-open-drain;

			camera_main_af@0c {
				compatible = "mediatek,camera_main_af";
				phandle = <0xa3>;
				reg = <0xc>;
				status = "okay";
			};

			camera_main_eeprom@58 {
				compatible = "mediatek,camera_main_eeprom";
				phandle = <0xa1>;
				reg = <0x58>;
				status = "okay";
			};

			camera_main_two_eeprom@54 {
				compatible = "mediatek,camera_main_two_eeprom";
				phandle = <0xa2>;
				reg = <0x54>;
				status = "okay";
			};

			camera_sub_eeprom@51 {
				compatible = "mediatek,camera_sub_eeprom";
				phandle = <0xa0>;
				reg = <0x51>;
				status = "okay";
			};
		};
	};

	fragment@71 {
		target = <0xffffffff>;

		__overlay__ {
			#address-cells = <0x1>;
			#size-cells = <0x0>;
			clock-frequency = <0xf4240>;
			mediatek,use-open-drain;

			camera_sub@1a {
				compatible = "mediatek,camera_sub";
				phandle = <0xa4>;
				pinctrl-0 = <0x66 0x67>;
				pinctrl-1 = <0x68 0x69>;
				pinctrl-names = "i2c_on", "i2c_off";
				reg = <0x1a>;
				status = "okay";
			};
		};
	};

	fragment@72 {
		target = <0xffffffff>;

		__overlay__ {
			#address-cells = <0x1>;
			#size-cells = <0x0>;
			clock-frequency = <0xf4240>;
			mediatek,use-open-drain;

			camera_main@1a {
				compatible = "mediatek,camera_main";
				phandle = <0xa5>;
				pinctrl-0 = <0x6a 0x6b>;
				pinctrl-1 = <0x6c 0x6d>;
				pinctrl-names = "i2c_on", "i2c_off";
				reg = <0x1a>;
				status = "okay";
			};
		};
	};

	fragment@73 {
		target = <0xffffffff>;

		__overlay__ {
			#address-cells = <0x1>;
			#size-cells = <0x0>;
			clock-frequency = <0x61a80>;
			mediatek,use-open-drain;

			camera_main_four@3f {
				compatible = "mediatek,camera_main_four";
				phandle = <0xa8>;
				pinctrl-0 = <0x76 0x77>;
				pinctrl-1 = <0x78 0x79>;
				pinctrl-names = "i2c_on", "i2c_off";
				reg = <0x3f>;
				status = "okay";
			};

			camera_main_three@2d {
				compatible = "mediatek,camera_main_three";
				phandle = <0xa7>;
				pinctrl-0 = <0x72 0x73>;
				pinctrl-1 = <0x74 0x75>;
				pinctrl-names = "i2c_on", "i2c_off";
				reg = <0x2d>;
				status = "okay";
			};

			camera_main_two@37 {
				compatible = "mediatek,camera_main_two";
				phandle = <0xa6>;
				pinctrl-0 = <0x6e 0x6f>;
				pinctrl-1 = <0x70 0x71>;
				pinctrl-names = "i2c_on", "i2c_off";
				reg = <0x37>;
				status = "okay";
			};
		};
	};

	fragment@74 {
		target = <0xffffffff>;

		__overlay__ {
			#address-cells = <0x1>;
			#size-cells = <0x0>;
			clock-frequency = <0x61a80>;
			mediatek,use-open-drain;
			pinctrl-0 = <0x7a>;
			pinctrl-names = "default";
			status = "okay";

			sx9360-i2c@28 {
				#sx9360,vdd_en = <0xffffffff 0x2b 0x0>;
				compatible = "sx9360";
				interrupt-parent = <0xffffffff>;
				interrupts = <0x13 0x0>;
				pinctrl-0 = <0x7b>;
				pinctrl-names = "default";
				reg = <0x28>;
				status = "okay";
				sx9360,againfreq_reg = <0x11>;
				sx9360,gainrawfilt_reg = <0xa>;
				sx9360,hallic_cert_detect = <0x0>;
				sx9360,hallic_detect = <0x0>;
				sx9360,hyst_reg = <0x35>;
				sx9360,nirq-gpio = <0xffffffff 0x13 0x0>;
				sx9360,proxthresh_reg = <0x10>;
				sx9360,refagainfreq_reg = <0x36>;
				sx9360,refgainrawfilt_reg = <0x22>;
				sx9360,refresolution_reg = <0xf>;
				sx9360,reggnrlctrl2_reg = <0x19>;
				sx9360,regproxctrl3_reg = <0xe>;
				sx9360,resolution_reg = <0xf>;
			};
		};
	};

	fragment@75 {
		target = <0xffffffff>;

		__overlay__ {

			grip-int {
				phandle = <0x7b>;

				pins_cmd_dat {
					bias-disable;
					pinmux = <0x1300>;
					slew-rate = <0x0>;
				};
			};

			grip-ldo-en {
				phandle = <0x7a>;

				pins_cmd_dat {
					output-high;
					pinmux = <0x2b00>;
					slew-rate = <0x1>;
				};
			};

			grip-sub-i2c {
				phandle = <0x3>;

				pins_cmd0_dat {
					bias-disable;
					pinmux = <0x9800>;
					slew-rate = <0x0>;
				};

				pins_cmd1_dat {
					bias-disable;
					pinmux = <0xa500>;
					slew-rate = <0x0>;
				};
			};

			grip-sub-int {
				phandle = <0x4>;

				pins_cmd_dat {
					bias-disable;
					pinmux = <0x1100>;
					slew-rate = <0x0>;
				};
			};
		};
	};

	fragment@76 {
		target = <0xffffffff>;

		__overlay__ {

			s2mu106@3A {

				s2mu106-haptic {
					compatible = "sec,s2mu106-haptic";
					haptic,max_timeout = <0x2710>;
					haptic,motor_en = <0xffffffff 0x96 0x96>;
					haptic,operation_mode = <0x1>;
					haptic,type = "COINDC";
					status = "okay";
				};
			};
		};
	};

	fragment@77 {
		target = <0xffffffff>;

		__overlay__ {

			tsp_irq_active {
				phandle = <0x7c>;

				pins_cmd_dat {
					bias-disable;
					input-enable;
					pinmux = <0xa00>;
					slew-rate = <0x0>;
				};
			};
		};
	};

	fragment@78 {
		target = <0xffffffff>;

		__overlay__ {
			regulator-min-microvolt = <0x2dc6c0>;
		};
	};

	fragment@79 {
		target = <0xffffffff>;

		__overlay__ {
			status = "okay";

			mms_ts@48 {
				compatible = "melfas,mms_ts";
				enable_settings_aot;
				melfas,area-size = <0x85 0x10a 0x155>;
				melfas,event_info = <0x8 0xc>;
				melfas,fod_info = <0xf 0xe 0x1b>;
				melfas,fw_name = "tsp_melfas/mss100_a50.fw";
				melfas,fw_name_old = "tsp_melfas/mss100_a50_p01.fw";
				melfas,irq-gpio = <0xffffffff 0xa 0x0>;
				melfas,max_x_y = <0xfff 0xfff>;
				melfas,node_info = <0xf 0x20 0x0>;
				melfas,project_name = "A505";
				melfas,scl-gpio = <0xffffffff 0x59 0x0>;
				melfas,sda-gpio = <0xffffffff 0x5a 0x0>;
				melfas,support_lpm = "true";
				pinctrl-0 = <0x6>;
				pinctrl-1 = <0x7>;
				pinctrl-2 = <0x8>;
				pinctrl-3 = <0x9>;
				pinctrl-names = "on_state", "off_state", "tsp_ldo_en", "tsp_ldo_dis_en";
				reg = <0x48>;
				status = "disabled";
				support_ear_detect_mode;
				support_fod;
			};

			touchscreen@50 {
				compatible = "imagis,ist40xx-ts";
				enable_settings_aot;
				imagis,afe_base = <0x113>;
				imagis,cm_spec = <0x12c 0x898 0x2b>;
				imagis,ic-version = "ist40xx";
				imagis,irq-gpio = <0xffffffff 0xa 0x0>;
				imagis,project-name = "a31";
				imagis,regulator_avdd = "vcama2";
				imagis,tclm_level = <0x2>;
				imagis,x_resolution = <0x438>;
				imagis,y_resolution = <0x960>;
				pinctrl-0 = <0x7c>;
				pinctrl-names = "default";
				reg = <0x50>;
				status = "ok";
				support_fod;
				support_open_short_test;
			};
		};
	};

	fragment@8 {
		target = <0xffffffff>;

		__overlay__ {
			mtk_pull_down_stay_enable = <0x0>;
			mtk_switch_stay_off = <0x1>;
		};
	};

	fragment@80 {
		target = <0xffffffff>;

		__overlay__ {

			s2mpb03_i2c_default {
				phandle = <0x5>;

				pins_cmd_dat {
					bias-disable;
					input-enable;
					pinmux = <0x4f00 0x5000>;
					slew-rate = <0x0>;
				};
			};
		};
	};

	fragment@81 {
		target = <0xffffffff>;

		__overlay__ {
			io-channels = <0xffffffff 0x4>;
		};
	};

	fragment@82 {
		target = <0xffffffff>;

		__overlay__ {
			io-channels = <0xffffffff 0x0>;
		};
	};

	fragment@83 {
		target = <0xffffffff>;

		__overlay__ {

			speaker_amp@34 {
				phandle = <0xa9>;
				status = "disabled";
			};
		};
	};

	fragment@84 {
		target = <0xffffffff>;

		__overlay__ {
			#address-cells = <0x1>;
			#size-cells = <0x0>;
			clock-frequency = <0x61a80>;
			id = <0x12>;
			status = "okay";

			sma1303@1e {
				#sound-dai-cells = <0x0>;
				compatible = "siliconmitus,sma1303";
				init-vol = <0x31>;
				phandle = <0x7d>;
				reg = <0x1e>;
				status = "okay";
				sys-clk-id = <0x3>;
			};
		};
	};

	fragment@85 {
		target = <0xffffffff>;

		__overlay__ {
			mtk_spk_i2s_in = <0x2>;
			mtk_spk_i2s_out = <0x1>;

			mediatek,speaker-codec {
				sound-dai = <0x7d>;
			};
		};
	};

	fragment@86 {
		target = <0xffffffff>;

		__overlay__ {

			pins_cmd_dat {
				pinmux = <0x2500 0x2600 0x2400>;
			};
		};
	};

	fragment@87 {
		target = <0xffffffff>;

		__overlay__ {

			pins_cmd_dat {
				pinmux = <0x2501 0x2601 0x2401>;
			};
		};
	};

	fragment@88 {
		target = <0xffffffff>;

		__overlay__ {

			pins_cmd_dat {
				pinmux = <0x2800>;
			};
		};
	};

	fragment@89 {
		target = <0xffffffff>;

		__overlay__ {

			pins_cmd_dat {
				pinmux = <0x2801>;
			};
		};
	};

	fragment@9 {
		target = <0xffffffff>;

		__overlay__ {
			accdet-mic-mode = <0x1>;
			accdet-mic-vol = <0x6>;
			accdet-plugout-debounce = <0x1>;
			deb-gpios = <0xffffffff 0xc 0x0>;
			headset-eint-level-pol = <0x8>;
			headset-four-key-threshold = <0x0 0x3a 0x79 0xc0 0x190>;
			headset-mode-setting = <0x500 0x500 0x1 0x1f0 0x800 0x800 0x20 0x44>;
			headset-three-key-threshold = <0x0 0x50 0xdc 0x190>;
			headset-three-key-threshold-CDD = <0x0 0x79 0xc0 0x258>;
			headset-vol-threshold = <0x0 0x24e 0x24f 0x690 0xa28>;
			interrupt-parent = <0xffffffff>;
			interrupts = <0xc 0x8 0xc 0x0 0x29 0x8 0x29 0x0>;
			moist-deb-gpios = <0xffffffff 0x29 0x0>;
			moist-plugin-debounce = <0x80>;
			moist-plugout-debounce = <0x3e8>;
			moisture-plug-in-threshold = <0x0 0x202 0x2ed>;
			moisture-water-r = <0xc350>;
			moisture_use_ext_res = <0x1>;
			pinctrl-0 = <0x10>;
			pinctrl-1 = <0x11>;
			pinctrl-2 = <0x12>;
			pinctrl-names = "default", "state_eint_as_int", "state_moisteint";
			plugin-debounce = <0x9c400>;
			plugout-debounce = <0x271>;
			status = "okay";
		};
	};

	fragment@90 {
		target = <0xffffffff>;

		__overlay__ {
			headset-four-key-threshold = <0x0 0x55 0x7c 0xd5 0x1a4>;
			headset-vol-threshold = <0x0 0x258 0x259 0x7d0 0xa28>;
		};
	};

	fragment@91 {
		target = <0xffffffff>;

		__overlay__ {
			cd_level = [00];
		};
	};

	fragment@92 {
		target = <0xffffffff>;

		__overlay__ {

			touchscreen@50 {
				imagis,gpio-tsp_fw_det = <0xffffffff 0x2a 0x0>;
				pinctrl-0 = <0x7c 0x7e>;
			};
		};
	};

	fragment@93 {
		target = <0xffffffff>;

		__overlay__ {

			fw_det_active {
				phandle = <0x7e>;

				pins_cmd_dat {
					bias-disable;
					input-enable;
					pinmux = <0x2a00>;
					slew-rate = <0x0>;
				};
			};
		};
	};

	fragment@94 {
		target = <0xffffffff>;

		__overlay__ {

			sx9360-i2c@28 {
				sx9360,againfreq_reg = <0x11>;
				sx9360,gainrawfilt_reg = <0xa>;
				sx9360,hallic_cert_detect = <0x0>;
				sx9360,hallic_detect = <0x0>;
				sx9360,hyst_reg = <0x15>;
				sx9360,proxthresh_reg = <0x14>;
				sx9360,refagainfreq_reg = <0x36>;
				sx9360,refgainrawfilt_reg = <0x22>;
				sx9360,refresolution_reg = <0xf>;
				sx9360,reggnrlctrl2_reg = <0x19>;
				sx9360,regproxctrl3_reg = <0xa>;
				sx9360,resolution_reg = <0xf>;
			};
		};
	};

	fragment@lcd {
		target-path = [2f 00];

		__overlay__ {

			ea8076 {
				id_match = <0x0 0x0>;
				lcm_params-dsi-data_rate = <0x4b0>;
				lcm_params-dsi-horizontal_backporch = <0xe>;
				lcm_params-dsi-horizontal_frontporch = <0x1e>;
				lcm_params-dsi-horizontal_sync_active = <0xa>;
				lcm_params-dsi-lane_num = <0x4>;
				lcm_params-dsi-mode = <0x0>;
				lcm_params-dsi-packet_size = <0x100>;
				lcm_params-dsi-ps = <0x2>;
				lcm_params-dsi-ssc_disable = <0x1>;
				lcm_params-dsi-vertical_backporch = <0xc>;
				lcm_params-dsi-vertical_frontporch = <0x5>;
				lcm_params-dsi-vertical_sync_active = <0x2>;
				lcm_params-physical_height = <0x94>;
				lcm_params-physical_width = <0x43>;
				lcm_params-resolution = <0x438 0x960>;
				lcm_params-types = <0x2>;
				phandle = <0x33>;
				smcdsd_board = <0x34>;
			};

			lcd_fixed_regulator {
				compatible = "simple-bus";
				phandle = <0x9c>;

				__gpio_lcd_1P8_en {
					compatible = "regulator-fixed";
					enable-active-high;
					gpio = <0xffffffff 0x19 0x0>;
					phandle = <0x9e>;
					regulator-boot-on;
					regulator-name = "gpio_lcd_1p8_en";
				};

				__gpio_lcd_3P0_en {
					compatible = "regulator-fixed";
					enable-active-high;
					gpio = <0xffffffff 0x99 0x0>;
					phandle = <0x9f>;
					regulator-boot-on;
					regulator-name = "gpio_lcd_3p0_en";
				};

				__gpio_lcd_rst {
					compatible = "regulator-fixed";
					enable-active-high;
					gpio = <0xffffffff 0x2d 0x0>;
					phandle = <0x9d>;
					regulator-boot-on;
					regulator-name = "gpio_lcd_rst";
				};
			};

			panel {
				compatible = "samsung,mtk-dsi-panel";
				smcdsd_panel = <0x33>;
			};

			smcdsd_board_ea8076 {
				gpio_con = <0xffffffff 0x5c 0x0>;
				gpio_det = <0xffffffff 0xb3 0x1>;
				gpio_err = <0xffffffff 0x1c 0x1>;
				gpio_pcd = <0xffffffff 0x36 0x1>;
				phandle = <0x34>;

				panel_power_disable {
					type = "regulator,disable", "gpio_lcd_3p0_en", "delay,usleep", "5000", "regulator,disable", "gpio_lcd_1p8_en", "delay,usleep", "5000";
				};

				panel_power_enable {
					type = "regulator,enable", "gpio_lcd_1p8_en", "delay,usleep", "2000", "regulator,enable", "gpio_lcd_3p0_en", "delay,usleep", "10000";
				};

				panel_regulator_init {
					type = "regulator,enable", "gpio_lcd_1p8_en", "regulator,enable", "gpio_lcd_3p0_en", "regulator,enable", "gpio_lcd_rst";
				};

				panel_reset_disable {
					type = "regulator,disable", "gpio_lcd_rst", "delay,usleep", "10000";
				};

				panel_reset_enable {
					type = "delay,usleep", "1000", "regulator,enable", "gpio_lcd_rst", "delay,usleep", "1000", "regulator,disable", "gpio_lcd_rst", "delay,usleep", "1000", "regulator,enable", "gpio_lcd_rst", "delay,usleep", "11000";
				};
			};
		};
	};

	fragment@model {
		target-path = [2f 00];

		__overlay__ {

			aliases {
				i2c23 = "/i2c@23";
				i2c30 = "/i2c@30";
			};

			firmware {

				android {
					compatible = "android,firmware";

					fstab {
						compatible = "android,fstab";
						status = "disabled";
					};

					vbmeta {
						compatible = "android,vbmeta";
						parts = "vbmeta,boot,system,vendor,product,odm,prism,optics,vbmeta_samsung,recovery,dtbo,lk,tee1";
					};
				};
			};

			i2-gpio-s2mpb03 {
				#address-cells = <0x1>;
				#size-cells = <0x0>;
				compatible = "i2c-gpio";
				gpios = <0xffffffff 0x50 0x0 0xffffffff 0x4f 0x0>;
				i2c-gpio,delay-us = <0x2>;
				pinctrl-0 = <0x5>;
				pinctrl-names = "default";
				status = "okay";

				s2mpb03@56 {
					additional_reg_init;
					compatible = "samsung,s2mpb03pmic";
					reg = <0x56>;

					regulators {

						s2mpb03-ldo1 {
							phandle = <0x89>;
							regulator-max-microvolt = <0x10c8e0>;
							regulator-min-microvolt = <0x100590>;
							regulator-name = "s2mpb03-ldo1";
						};

						s2mpb03-ldo2 {
							phandle = <0x8a>;
							regulator-max-microvolt = <0x10c8e0>;
							regulator-min-microvolt = <0x100590>;
							regulator-name = "s2mpb03-ldo2";
						};

						s2mpb03-ldo3 {
							phandle = <0x8b>;
							regulator-max-microvolt = <0x1b7740>;
							regulator-min-microvolt = <0x1b7740>;
							regulator-name = "s2mpb03-ldo3";
						};

						s2mpb03-ldo4 {
							phandle = <0x8c>;
							regulator-max-microvolt = <0x124f80>;
							regulator-min-microvolt = <0x124f80>;
							regulator-name = "s2mpb03-ldo4";
						};

						s2mpb03-ldo5 {
							phandle = <0x8d>;
							regulator-max-microvolt = <0x2c4020>;
							regulator-min-microvolt = <0x2ab980>;
							regulator-name = "s2mpb03-ldo5";
						};

						s2mpb03-ldo6 {
							phandle = <0x8e>;
							regulator-max-microvolt = <0x2ab980>;
							regulator-min-microvolt = <0x2ab980>;
							regulator-name = "s2mpb03-ldo6";
						};

						s2mpb03-ldo7 {
							phandle = <0x8f>;
							regulator-max-microvolt = <0x2c4020>;
							regulator-min-microvolt = <0x2ab980>;
							regulator-name = "s2mpb03-ldo7";
						};
					};
				};
			};

			i2c@23 {
				#address-cells = <0x1>;
				#size-cells = <0x0>;
				cell-index = <0x17>;
				compatible = "i2c-gpio";
				gpios = <0xffffffff 0x98 0x0 0xffffffff 0xa5 0x0>;
				i2c-gpio,delay-us = <0x2>;
				phandle = <0x88>;
				pinctrl-0 = <0x3>;
				pinctrl-names = "default";
				status = "okay";

				sx9360_sub-i2c@28 {
					compatible = "sx9360_sub";
					interrupt-parent = <0xffffffff>;
					interrupts = <0x11 0x0>;
					pinctrl-0 = <0x4>;
					pinctrl-names = "default";
					reg = <0x28>;
					status = "okay";
					sx9360,againfreq_reg = <0x15>;
					sx9360,gainrawfilt_reg = <0x12>;
					sx9360,hyst_reg = <0x15>;
					sx9360,proxthresh_reg = <0x1f>;
					sx9360,refagainfreq_reg = <0x36>;
					sx9360,refgainrawfilt_reg = <0x22>;
					sx9360,refresolution_reg = <0xf>;
					sx9360,resolution_reg = <0xf>;
					sx9360_sub,hallic_cert_detect = <0x0>;
					sx9360_sub,hallic_detect = <0x0>;
					sx9360_sub,nirq-gpio = <0xffffffff 0x11 0x0>;
				};
			};

			i2c@30 {
				#address-cells = <0x1>;
				#i2c-gpio,delay-us = <0x2>;
				#size-cells = <0x0>;
				cell-index = <0x1e>;
				compatible = "i2c-gpio";
				gpios = <0xffffffff 0x50 0x0 0xffffffff 0x4f 0x0>;
				phandle = <0x87>;
				pinctrl-0 = <0x1 0x2>;
				pinctrl-names = "default";
				status = "okay";

				s2mpb03_pmic@56 {
					compatible = "samsung,s2mpb03pmic";
					reg = <0x56>;
					s2mpb03,wakeup;

					regulators {

						s2mpb03-ldo1 {
							phandle = <0x60>;
							regulator-max-microvolt = <0x10c8e0>;
							regulator-min-microvolt = <0x100590>;
							regulator-name = "CAM0_s2mpb03-l1";
						};

						s2mpb03-ldo2 {
							phandle = <0x63>;
							regulator-max-microvolt = <0x10c8e0>;
							regulator-min-microvolt = <0xf4240>;
							regulator-name = "CAM0_s2mpb03-l2";
						};

						s2mpb03-ldo3 {
							phandle = <0x61>;
							regulator-max-microvolt = <0x1b7740>;
							regulator-min-microvolt = <0x1b7740>;
							regulator-name = "CAM0_s2mpb03-l3";
						};

						s2mpb03-ldo4 {
							phandle = <0x64>;
							regulator-max-microvolt = <0x124f80>;
							regulator-min-microvolt = <0x10c8e0>;
							regulator-name = "CAM0_s2mpb03-l4";
						};

						s2mpb03-ldo5 {
							phandle = <0x5f>;
							regulator-max-microvolt = <0x2c4020>;
							regulator-min-microvolt = <0x2ab980>;
							regulator-name = "CAM0_s2mpb03-l5";
						};

						s2mpb03-ldo6 {
							phandle = <0x65>;
							regulator-max-microvolt = <0x2ab980>;
							regulator-min-microvolt = <0x2ab980>;
							regulator-name = "CAM0_s2mpb03-l6";
						};

						s2mpb03-ldo7 {
							phandle = <0x62>;
							regulator-max-microvolt = <0x2c4020>;
							regulator-min-microvolt = <0x2ab980>;
							regulator-name = "CAM0_s2mpb03-l7";
						};
					};
				};
			};

			muic {
				dcd_timeout;
				new_factory;
			};

			reserved-memory {

				ion-rbin-heap {
					alignment = <0x0 0x1000>;
					alloc-ranges = <0x0 0x40000000 0x0 0x80000000>;
					compatible = "mediatek,ion-rbin-heap";
					ion,recyclable;
					size = <0x0 0xc800000>;
				};
			};

			sec_thermistor@0 {
				adc_array = <0x6a 0x7b 0xac 0xcc 0xf0 0x125 0x162 0x1aa 0x1ff 0x241 0x272 0x2f2 0x34a 0x3b2 0x462 0x53a 0x63c 0x755 0x7de 0x89d 0x964 0x9f0 0xb15 0xc67 0xd85>;
				compatible = "samsung,sec-thermistor";
				id = <0x0>;
				io-channel-names = "ap_therm";
				io-channel-ranges;
				io-channels = <0xffffffff 0x4>;
				status = "okay";
				temp_array = <0x352 0x320 0x2bc 0x28a 0x258 0x226 0x1f4 0x1c2 0x190 0x172 0x15e 0x12c 0x10e 0xfa 0xc8 0x96 0x64 0x32 0x1e 0x0 0xffffffe2 0xffffffce 0xffffff9c 0xffffff6a 0xffffff38>;
				thermistor_name = "sec-ap-thermistor";
				use_iio_processed;
			};

			sec_thermistor@1 {
				adc_array = <0x7e 0xa0 0xc1 0xdd 0x110 0x130 0x182 0x1c7 0x21e 0x263 0x299 0x311 0x35f 0x3b9 0x471 0x550 0x65d 0x764 0x80a 0x856 0x99b 0x9d0 0xa76 0xc73 0xd0b>;
				compatible = "samsung,sec-thermistor";
				id = <0x1>;
				io-channel-names = "pa_therm";
				io-channel-ranges;
				io-channels = <0xffffffff 0x0>;
				status = "okay";
				temp_array = <0x352 0x320 0x2bc 0x28a 0x258 0x226 0x1f4 0x1c2 0x190 0x172 0x15e 0x12c 0x10e 0xfa 0xc8 0x96 0x64 0x32 0x1e 0x0 0xffffffe2 0xffffffce 0xffffff9c 0xffffff6a 0xffffff38>;
				thermistor_name = "sec-pa-thermistor";
				use_iio_processed;
			};

			sec_thermistor@2 {
				adc_array = <0x6f 0x7d 0xaf 0xcf 0xf6 0x12a 0x165 0x1b2 0x20c 0x24f 0x281 0x305 0x365 0x3c7 0x477 0x557 0x652 0x772 0x7fb 0x8b9 0x987 0xa01 0xb4b 0xc88 0xd92>;
				compatible = "samsung,sec-thermistor";
				id = <0x2>;
				io-channel-names = "wf_therm";
				io-channel-ranges;
				io-channels = <0xffffffff 0x1>;
				status = "okay";
				temp_array = <0x352 0x320 0x2bc 0x28a 0x258 0x226 0x1f4 0x1c2 0x190 0x172 0x15e 0x12c 0x10e 0xfa 0xc8 0x96 0x64 0x32 0x1e 0x0 0xffffffe2 0xffffffce 0xffffff9c 0xffffff6a 0xffffff38>;
				thermistor_name = "sec-wf-thermistor";
				use_iio_processed;
			};

			shub {
				acc-lsm6dsl-position = <0x0>;
				brightness-array = <0xf 0x28 0x32 0x4d 0xff>;
				brightness-array-len = <0x5>;
				compatible = "shub";
				light-cam-br = <0x3c 0x3c>;
				light-cam-lux = <0x64 0xc8>;
				light-position = <0x2a 0x36 0x8 0x1b 0x2 0x8>;
				mag-check-nfc = <0xffffffff 0x34 0x0>;
				mag-yas539-array = [28 94 00 56 ff 7c ff 98 26 0a ff 6f ff bd ff e5 29 f4];
				mag-yas539-nfc-array = [28 49 00 76 ff 7c ff da 25 ab ff 4b ff 51 ff da 29 67];
				mag-yas539-position = <0x3>;
			};

			usb_notifier {
				compatible = "samsung,usb-notifier";
				disable_host_wakelock;
			};
		};
	};

	fragment@smd {
		target-path = [2f 00];

		__overlay__ {

			fixed_regulator_btp_ldo {
				compatible = "regulator-fixed";
				enable-active-high;
				gpio = <0xffffffff 0x4d 0x0>;
				regulator-name = "btp_ldo";
				skip-gpio-request;
			};

			fixed_regulator_grip_ldo {
				compatible = "regulator-fixed";
				enable-active-high;
				gpio = <0xffffffff 0x2b 0x0>;
				regulator-name = "grip_ldo";
				skip-gpio-request;
			};

			fixed_regulator_lcd_en_1p8_ldo {
				compatible = "regulator-fixed";
				enable-active-high;
				gpio = <0xffffffff 0x19 0x0>;
				regulator-name = "lcd_en_1p8_ldo";
				skip-gpio-request;
			};

			fixed_regulator_lcd_en_3p0_ldo {
				compatible = "regulator-fixed";
				enable-active-high;
				gpio = <0xffffffff 0x99 0x0>;
				regulator-name = "lcd_en_3p0_ldo";
				skip-gpio-request;
			};

			fixed_regulator_rcam4_avdd_ldo {
				compatible = "regulator-fixed";
				enable-active-high;
				gpio = <0xffffffff 0x62 0x0>;
				regulator-name = "rcam4_avdd_ldo";
				skip-gpio-request;
			};

			fixed_regulator_rcam4_dvdd_ldo {
				compatible = "regulator-fixed";
				enable-active-high;
				gpio = <0xffffffff 0x1d 0x0>;
				regulator-name = "rcam4_dvdd_ldo";
				skip-gpio-request;
			};

			fixed_regulator_sensor_ldo {
				compatible = "regulator-fixed";
				enable-active-high;
				gpio = <0xffffffff 0xb2 0x0>;
				regulator-name = "sensor_ldo";
				skip-gpio-request;
			};

			samsung_mobile_device {
				compatible = "simple-bus";
				phandle = <0x7f>;

				abc_hub {
					compatible = "samsung,abc_hub";
					status = "okay";

					bootc {
						bootc,time_spec_eng = <0x249f0>;
						bootc,time_spec_fac = <0x186a0>;
						bootc,time_spec_user = <0x186a0>;
					};
				};

				battery {
					battery,adc_check_count = <0x5>;
					battery,age_data = <0x0 0x111c 0x10d6 0x10b8 0x5d 0x12c 0x1108 0x10c2 0x10a4 0x5c 0x190 0x10f4 0x10ae 0x1090 0x5b 0x2bc 0x10e0 0x109a 0x107c 0x5a 0x3e8 0x10ae 0x1068 0x104a 0x59>;
					battery,batt_data_version = <0x1>;
					battery,battery_check_type = <0x0>;
					battery,battery_full_capacity = <0x1388>;
					battery,cable_check_type = <0x4>;
					battery,cable_source_type = <0x1>;
					battery,charger_name = "s2mu106-charger";
					battery,charging_reset_time = <0x0>;
					battery,charging_total_time = <0x3840>;
					battery,chg_charging_limit_current = <0x4e2>;
					battery,chg_float_voltage = <0x111c>;
					battery,chg_gpio_full_check = <0x0>;
					battery,chg_high_temp = <0x1cc>;
					battery,chg_high_temp_recovery = <0x1b8>;
					battery,chg_input_limit_current = <0x3e8>;
					battery,chg_polarity_full_check = <0x1>;
					battery,chg_temp_check_type = <0x2>;
					battery,chg_thermal_source = <0x0>;
					battery,chip_vendor = "MTK";
					battery,cisd_alg_index = <0x8>;
					battery,cisd_max_voltage_thr = <0x1388>;
					battery,cv_data = <0x8c4 0x348 0x80f 0x85a 0x352 0x7e0 0x7f1 0x35c 0x7a3 0x742 0x366 0x736 0x6df 0x370 0x6f8 0x620 0x37a 0x67a 0x5b3 0x384 0x635 0x53d 0x38e 0x5bb 0x490 0x398 0x525 0x423 0x3a2 0x4a9 0x3a4 0x3ac 0x3f2 0x313 0x3b6 0x339 0x2a6 0x3c0 0x244 0x252 0x3ca 0x16f 0x1f2 0x3d4 0x7a 0x1c9 0x3de 0x3c 0x1c2 0x3e8 0x0>;
					battery,expired_time = <0x35e8>;
					battery,fgsrc_switch_name = "s2mu106-fuelgauge";
					battery,fuelgauge_name = "s2mu106-fuelgauge";
					battery,full_check_count = <0x1>;
					battery,full_check_type = <0x2>;
					battery,full_check_type_2nd = <0x2>;
					battery,full_condition_soc = <0x5d>;
					battery,full_condition_type = <0x9>;
					battery,full_condition_vcell = <0x10b8>;
					battery,health_condition = <0x384 0x4b 0x4b0 0x41 0x5dc 0x37>;
					battery,high_temp_float = <0x1036>;
					battery,high_temp_topoff = <0xfa>;
					battery,hv_charging_total_time = <0x2a30>;
					battery,hv_input_current_by_siop_0 = <0x1f4>;
					battery,hv_input_current_by_siop_10 = <0x190>;
					battery,hv_input_current_by_siop_20 = <0x1f4>;
					battery,ignore_cisd_index = <0x0 0x0>;
					battery,ignore_cisd_index_d = <0x0 0x50>;
					battery,input_current_by_siop_0 = <0x3e8>;
					battery,input_current_by_siop_10 = <0x320>;
					battery,input_current_by_siop_20 = <0x3e8>;
					battery,low_temp_float = <0x111c>;
					battery,low_temp_topoff = <0xfa>;
					battery,max_charging_charge_power = <0x3a98>;
					battery,max_charging_current = <0x8fc>;
					battery,max_input_current = <0xbb8>;
					battery,max_input_voltage = <0x2328>;
					battery,mix_high_chg_temp = <0x1f4>;
					battery,mix_high_temp = <0x1a4>;
					battery,mix_high_temp_recovery = <0x186>;
					battery,monitor_initial_count = <0x0>;
					battery,normal_charging_total_time = <0x4650>;
					battery,overheatlimit_recovery = <0x2a8>;
					battery,overheatlimit_threshold = <0x2bc>;
					battery,ovp_uvlo_check_type = <0x3>;
					battery,pd_charging_charge_power = <0x3a98>;
					battery,polling_time = <0xa 0x1e 0x1e 0x1e 0xe10>;
					battery,polling_type = <0x1>;
					battery,pre_afc_input_current = <0x1f4>;
					battery,pre_afc_work_delay = <0x7d0>;
					battery,pre_wc_afc_input_current = <0x1f4>;
					battery,pre_wc_afc_work_delay = <0xfa0>;
					battery,prepare_ta_delay = <0x0>;
					battery,recharge_check_count = <0x1>;
					battery,recharge_condition_soc = <0x62>;
					battery,recharge_condition_type = <0x4>;
					battery,recharge_condition_vcell = <0x10d6>;
					battery,recharging_expired_time = <0x1518>;
					battery,recharging_total_time = <0x1518>;
					battery,rp_current_abnormal_rp3 = <0x708>;
					battery,rp_current_rdu_rp3 = <0x834>;
					battery,rp_current_rp1 = <0x1f4>;
					battery,rp_current_rp2 = <0x5dc>;
					battery,rp_current_rp3 = <0xbb8>;
					battery,siop_charging_limit_current = <0x3e8>;
					battery,siop_curr_type_num = <0x2>;
					battery,siop_fcc_0 = <0xffff 0xffff>;
					battery,siop_fcc_10 = <0xffff 0xffff>;
					battery,siop_fcc_20 = <0xffff 0xffff>;
					battery,siop_hv_charging_limit_current = <0x3e8>;
					battery,siop_hv_input_limit_current = <0x2bc>;
					battery,siop_hv_input_limit_current_2nd = <0x226>;
					battery,siop_icl_0 = <0x3e8 0x1f4>;
					battery,siop_icl_10 = <0x320 0x190>;
					battery,siop_icl_20 = <0x3e8 0x1f4>;
					battery,siop_input_limit_current = <0x4b0>;
					battery,siop_scenarios = <0x14 0xa 0x0>;
					battery,sleep_mode_limit_current = <0x1f4>;
					battery,standard_curr = <0x8fc>;
					battery,store_mode_charging_max = <0x46>;
					battery,store_mode_charging_min = <0x3c>;
					battery,swelling_drop_float_voltage = <0x1036>;
					battery,swelling_high_rechg_voltage = <0xfa0>;
					battery,swelling_high_temp_block = <0x19a>;
					battery,swelling_high_temp_recov = <0x186>;
					battery,swelling_low_rechg_voltage = <0x1086>;
					battery,swelling_low_temp_block_1st = <0x96>;
					battery,swelling_low_temp_block_2nd = <0x32>;
					battery,swelling_low_temp_recov_1st = <0xaa>;
					battery,swelling_low_temp_recov_2nd = <0x46>;
					battery,technology = <0x2>;
					battery,temp_adc_type = <0x1>;
					battery,temp_check_count = <0x1>;
					battery,temp_check_type = <0x1>;
					battery,temp_gap_bat_usb = <0xc8>;
					battery,temp_high_recovery_event = <0x1e0>;
					battery,temp_high_recovery_lpm = <0x1e0>;
					battery,temp_high_recovery_normal = <0x1e0>;
					battery,temp_high_threshold_event = <0x1f4>;
					battery,temp_high_threshold_lpm = <0x1f4>;
					battery,temp_high_threshold_normal = <0x1f4>;
					battery,temp_highlimit_recovery_event = <0x30c>;
					battery,temp_highlimit_recovery_lpm = <0x30c>;
					battery,temp_highlimit_recovery_normal = <0x30c>;
					battery,temp_highlimit_threshold_event = <0x320>;
					battery,temp_highlimit_threshold_lpm = <0x320>;
					battery,temp_highlimit_threshold_normal = <0x320>;
					battery,temp_low_recovery_event = <0x14>;
					battery,temp_low_recovery_lpm = <0x14>;
					battery,temp_low_recovery_normal = <0x14>;
					battery,temp_low_threshold_event = <0x0>;
					battery,temp_low_threshold_lpm = <0x0>;
					battery,temp_low_threshold_normal = <0x0>;
					battery,temp_table_adc = <0x75 0x82 0xb9 0xdb 0x104 0x13a 0x17b 0x1c8 0x227 0x266 0x297 0x33a 0x393 0x3df 0x4a1 0x585 0x692 0x7b6 0x866 0x902 0x9d8 0xa2f 0xb79 0xcb2 0xdeb>;
					battery,temp_table_data = <0x352 0x320 0x2bc 0x28a 0x258 0x226 0x1f4 0x1c2 0x190 0x172 0x15e 0x12c 0x10e 0xfa 0xc8 0x96 0x64 0x32 0x1e 0x0 0xffffffe2 0xffffffce 0xffffff9c 0xffffff6a 0xffffff38>;
					battery,thermal_source = <0x2>;
					battery,ttf_capacity = <0x104f>;
					battery,ttf_hv_charge_current = <0x807>;
					battery,usb_charging_total_time = <0x8ca0>;
					battery,usb_protection_temp = <0x262>;
					battery,usb_temp_check_type = <0x0>;
					battery,usb_thermal_source = <0x5>;
					battery,vendor = "Battery";
					battery,wc_full_input_limit_current = <0x64>;
					battery,wire_cold_cool3_thresh = <0x0>;
					battery,wire_cool1_current = <0x8fc>;
					battery,wire_cool1_normal_thresh = <0x96>;
					battery,wire_cool2_cool1_thresh = <0x96>;
					battery,wire_cool2_current = <0x41a>;
					battery,wire_cool3_cool2_thresh = <0x32>;
					battery,wire_cool3_current = <0x1f4>;
					battery,wire_normal_warm_thresh = <0x1a4>;
					battery,wire_warm_current = <0x640>;
					battery,wire_warm_overheat_thresh = <0x1f4>;
					battery,wireless_cc_cv = <0x55>;
					battery,wireless_otg_input_current = <0x384>;
					battery,wpc_charging_limit_current = <0x3e8>;
					battery,wpc_high_recovery_normal = <0x1ae>;
					battery,wpc_high_temp = <0x17c>;
					battery,wpc_high_temp_recovery = <0x168>;
					battery,wpc_high_threshold_normal = <0x1c2>;
					battery,wpc_input_limit_current = <0x258>;
					battery,wpc_lcd_on_high_temp = <0x17c>;
					battery,wpc_lcd_on_high_temp_rec = <0x168>;
					battery,wpc_lcd_on_input_limit_current = <0x1c2>;
					battery,wpc_low_recovery_normal = <0x14>;
					battery,wpc_low_threshold_normal = <0x0>;
					battery,wpc_store_charging_limit_current = <0x190>;
					battery,wpc_store_high_temp = <0x168>;
					battery,wpc_store_high_temp_recovery = <0x154>;
					battery,wpc_store_lcd_on_charging_limit_current = <0x190>;
					battery,wpc_store_lcd_on_high_temp = <0x168>;
					battery,wpc_store_lcd_on_high_temp_rec = <0x12c>;
					battery,wpc_temp_check_type = <0x0>;
					battery,wpc_temp_control_source = <0x1>;
					battery,wpc_temp_lcd_on_control_source = <0x1>;
					battery,wpc_thermal_source = <0x5>;
					compatible = "samsung,sec-battery";
					io-channel-names = "adc-temp", "n/a", "n/a", "n/a", "n/a";
					io-channels = <0xffffffff 0x3>;
					phandle = <0x84>;
					pinctrl-names = "default";
					status = "okay";
				};

				battery_params {
					battery,battery_data = <0x2c 0xb 0xab 0xa 0x29 0xa 0xb1 0x9 0x3d 0x9 0xcf 0x8 0x69 0x8 0x7 0x8 0xb7 0x7 0x5d 0x7 0xf3 0x6 0xb8 0x6 0x8b 0x6 0x68 0x6 0x4d 0x6 0x32 0x6 0xb 0x6 0xe2 0x5 0x9f 0x5 0x80 0x5 0x95 0x4 0x74 0x1 0x6a 0x8 0x0 0x8 0x96 0x7 0x2b 0x7 0xc1 0x6 0x56 0x6 0xec 0x5 0x81 0x5 0x17 0x5 0xad 0x4 0x42 0x4 0xd8 0x3 0x6d 0x3 0x3 0x3 0x99 0x2 0x2e 0x2 0xc4 0x1 0x59 0x1 0xef 0x0 0x84 0x0 0x1a 0x0 0xdc 0xf 0xa 0xa 0xa 0xa 0x37 0x36 0x36 0x36 0x35 0x35 0x36 0x36 0x37 0x37 0x38 0x39 0x39 0x3a 0x3c 0x42 0x4d 0x9a 0x10 0x49 0x44 0x12 0x0 0x8 0x2918 0x2710 0x2508 0x2301 0x20f9 0x1ef1 0x1cea 0x1ae2 0x18db 0x16d3 0x14cb 0x12c4 0x10bc 0xeb4 0xcad 0xaa5 0x89e 0x696 0x48e 0x287 0x7f 0xffffff50 0xabbc 0xa945 0xa6ce 0xa483 0xa24d 0xa031 0x9e41 0x9c64 0x9adb 0x9923 0x971c 0x95fc 0x9524 0x9479 0x93f2 0x9372 0x92b1 0x91e8 0x90a3 0x900c 0x8b91 0x7c49 0x0 0x2c 0xb 0xab 0xa 0x29 0xa 0xb1 0x9 0x3d 0x9 0xcf 0x8 0x69 0x8 0x7 0x8 0xb7 0x7 0x5d 0x7 0xf3 0x6 0xb8 0x6 0x8b 0x6 0x68 0x6 0x4d 0x6 0x32 0x6 0xb 0x6 0xe2 0x5 0x9f 0x5 0x80 0x5 0x95 0x4 0x74 0x1 0x86 0x8 0x1b 0x8 0xaf 0x7 0x44 0x7 0xd8 0x6 0x6d 0x6 0x1 0x6 0x96 0x5 0x2b 0x5 0xbf 0x4 0x54 0x4 0xe8 0x3 0x7d 0x3 0x11 0x3 0xa6 0x2 0x3b 0x2 0xcf 0x1 0x64 0x1 0xf8 0x0 0x8d 0x0 0x21 0x0 0xe3 0xf 0xa 0xa 0xa 0xa 0x37 0x36 0x36 0x36 0x35 0x35 0x36 0x36 0x37 0x37 0x38 0x39 0x39 0x3a 0x3c 0x42 0x4d 0x9a 0x60 0x48 0xdb 0xa 0x0 0x8 0x299e 0x2792 0x2585 0x2378 0x216c 0x1f5f 0x1d53 0x1b46 0x193a 0x172d 0x1521 0x1314 0x1108 0xefb 0xcee 0xae2 0x8d5 0x6c9 0x4bc 0x2b0 0xa3 0xffffff71 0xabbc 0xa945 0xa6ce 0xa483 0xa24d 0xa031 0x9e41 0x9c64 0x9adb 0x9923 0x971c 0x95fc 0x9524 0x9479 0x93f2 0x9372 0x92b1 0x91e8 0x90a3 0x900c 0x8b91 0x7c49 0x0 0x2c 0xb 0xab 0xa 0x29 0xa 0xb1 0x9 0x3d 0x9 0xcf 0x8 0x69 0x8 0x7 0x8 0xb7 0x7 0x5d 0x7 0xf3 0x6 0xb8 0x6 0x8b 0x6 0x68 0x6 0x4d 0x6 0x32 0x6 0xb 0x6 0xe2 0x5 0x9f 0x5 0x80 0x5 0x95 0x4 0x74 0x1 0xac 0x8 0x3f 0x8 0xd2 0x7 0x64 0x7 0xf7 0x6 0x8a 0x6 0x1c 0x6 0xaf 0x5 0x42 0x5 0xd4 0x4 0x67 0x4 0xfa 0x3 0x8d 0x3 0x1f 0x3 0xb2 0x2 0x45 0x2 0xd7 0x1 0x6a 0x1 0xfd 0x0 0x8f 0x0 0x22 0x0 0xe2 0xf 0xa 0xa 0xa 0xa 0x37 0x36 0x36 0x36 0x35 0x35 0x36 0x36 0x37 0x37 0x38 0x39 0x39 0x3a 0x3c 0x42 0x4d 0x9a 0x20 0x47 0xab 0xa 0x0 0x8 0x2a59 0x2844 0x262e 0x2418 0x2202 0x1fed 0x1dd7 0x1bc1 0x19ab 0x1796 0x1580 0x136a 0x1154 0xf3e 0xd29 0xb13 0x8fd 0x6e7 0x4d2 0x2bc 0xa6 0xffffff6f 0xabbc 0xa945 0xa6ce 0xa483 0xa24d 0xa031 0x9e41 0x9c64 0x9adb 0x9923 0x971c 0x95fc 0x9524 0x9479 0x93f2 0x9372 0x92b1 0x91e8 0x90a3 0x900c 0x8b91 0x7c49 0x0 0x2c 0xb 0xab 0xa 0x29 0xa 0xb1 0x9 0x3d 0x9 0xcf 0x8 0x69 0x8 0x7 0x8 0xb7 0x7 0x5d 0x7 0xf3 0x6 0xb8 0x6 0x8b 0x6 0x68 0x6 0x4d 0x6 0x32 0x6 0xb 0x6 0xe2 0x5 0x9f 0x5 0x80 0x5 0x95 0x4 0x74 0x1 0xd4 0x8 0x65 0x8 0xf6 0x7 0x86 0x7 0x17 0x7 0xa8 0x6 0x38 0x6 0xc9 0x5 0x5a 0x5 0xeb 0x4 0x7b 0x4 0xc 0x4 0x9d 0x3 0x2e 0x3 0xbe 0x2 0x4f 0x2 0xe0 0x1 0x70 0x1 0x1 0x1 0x92 0x0 0x23 0x0 0xe2 0xf 0xa 0xa 0xa 0xa 0x37 0x36 0x36 0x36 0x35 0x35 0x36 0x36 0x37 0x37 0x38 0x39 0x39 0x3a 0x3c 0x42 0x4d 0x9a 0xe0 0x45 0x7b 0xa 0x0 0x8 0x2b1b 0x28fc 0x26dd 0x24bd 0x229e 0x207f 0x1e60 0x1c40 0x1a21 0x1802 0x15e2 0x13c3 0x11a4 0xf84 0xd65 0xb46 0x926 0x707 0x4e8 0x2c8 0xa9 0xffffff6c 0xabbc 0xa945 0xa6ce 0xa483 0xa24d 0xa031 0x9e41 0x9c64 0x9adb 0x9923 0x971c 0x95fc 0x9524 0x9479 0x93f2 0x9372 0x92b1 0x91e8 0x90a3 0x900c 0x8b91 0x7c49 0x0 0x2c 0xb 0xab 0xa 0x29 0xa 0xb1 0x9 0x3d 0x9 0xcf 0x8 0x69 0x8 0x7 0x8 0xb7 0x7 0x5d 0x7 0xf3 0x6 0xb8 0x6 0x8b 0x6 0x68 0x6 0x4d 0x6 0x32 0x6 0xb 0x6 0xe2 0x5 0x9f 0x5 0x80 0x5 0x95 0x4 0x74 0x1 0x3e 0x9 0xc9 0x8 0x55 0x8 0xe0 0x7 0x6c 0x7 0xf7 0x6 0x83 0x6 0xf 0x6 0x9a 0x5 0x26 0x5 0xb1 0x4 0x3d 0x4 0xc8 0x3 0x54 0x3 0xdf 0x2 0x6b 0x2 0xf6 0x1 0x82 0x1 0xd 0x1 0x99 0x0 0x24 0x0 0xe0 0xf 0xa 0xa 0xa 0xa 0x37 0x36 0x36 0x36 0x35 0x35 0x36 0x36 0x37 0x37 0x38 0x39 0x39 0x3a 0x3c 0x42 0x4d 0x9a 0xc0 0x42 0x3 0xa 0x0 0x8 0x2d20 0x2ae8 0x28af 0x2676 0x243d 0x2204 0x1fcc 0x1d93 0x1b5a 0x1921 0x16e9 0x14b0 0x1277 0x103e 0xe06 0xbcd 0x994 0x75b 0x522 0x2ea 0xb1 0xffffff65 0xabbc 0xa945 0xa6ce 0xa483 0xa24d 0xa031 0x9e41 0x9c64 0x9adb 0x9923 0x971c 0x95fc 0x9524 0x9479 0x93f2 0x9372 0x92b1 0x91e8 0x90a3 0x900c 0x8b91 0x7c49 0x0>;
					phandle = <0x83>;
				};

				cable-info {
					default_charging_current = <0x834>;
					default_input_current = <0x708>;
					full_check_current_1st = <0x1e6>;
					full_check_current_2nd = <0xfa>;
					phandle = <0x86>;

					current_group_1 {
						cable_number = <0x2 0x13 0x15 0x16 0x17>;
						charging_current = <0x1f4>;
						input_current = <0x1f4>;
					};

					current_group_10 {
						cable_number = <0xb 0xe 0x10 0x1c 0x23>;
						charging_current = <0x8fc>;
						input_current = <0x28a>;
					};

					current_group_11 {
						cable_number = <0x1d 0x25>;
						charging_current = <0x4b0>;
						input_current = <0x1f4>;
					};

					current_group_12 {
						cable_number = <0x1 0x4 0x1e>;
						charging_current = <0x226>;
						input_current = <0x1db>;
					};

					current_group_13 {
						cable_number = <0x22>;
						charging_current = <0x92e>;
						input_current = <0x4b0>;
					};

					current_group_2 {
						cable_number = <0x19 0x1f>;
						charging_current = <0x3e8>;
						input_current = <0x3e8>;
					};

					current_group_3 {
						cable_number = <0x5 0x20>;
						charging_current = <0x5dc>;
						input_current = <0x5dc>;
					};

					current_group_4 {
						cable_number = <0x6 0x7 0x8 0x11 0x12 0x28>;
						charging_current = <0x8fc>;
						input_current = <0x672>;
					};

					current_group_5 {
						cable_number = <0x9>;
						charging_current = <0x8fc>;
						input_current = <0x672>;
					};

					current_group_6 {
						cable_number = <0xa 0xc 0xf 0x1b 0x21 0x24>;
						charging_current = <0x8fc>;
						input_current = <0x320>;
					};

					current_group_7 {
						cable_number = <0xd>;
						charging_current = <0x8fc>;
						input_current = <0x2bc>;
					};

					current_group_8 {
						cable_number = <0x18>;
						charging_current = <0x1c2>;
						input_current = <0x3e8>;
					};

					current_group_9 {
						cable_number = <0x1a>;
						charging_current = <0x708>;
						input_current = <0x708>;
					};
				};

				input_booster {
					#address-cells = <0x1>;
					#size-cells = <0x0>;
					allowed_resources = "0,1";
					compatible = "input_booster";
					cpu_cluster_policy = "6,0";
					ib_release_values = "-1,16,0";
					max_cluster_count = [33 00];
					max_resource_count = [33 00];
					resValcount = [32 00];
					status = "okay";

					booster_key@1 {
						input_booster,head_time = <0xc8>;
						input_booster,label = "key";
						input_booster,tail_time = <0xc8>;
						input_booster,type = <0x0>;

						inputbooster,resource {
							compatible = "resource";

							resource@1 {
								resource,label = "CPU";
								resource,value = <0x14a910 0x0>;
							};

							resource@2 {
								resource,label = "DDR";
								resource,value = <0x0 0x0>;
							};
						};
					};

					booster_key@2 {
						input_booster,head_time = <0x1>;
						input_booster,label = "touchkey";
						input_booster,tail_time = <0x12c>;
						input_booster,type = <0x1>;

						inputbooster,resource {
							compatible = "resource";

							resource@1 {
								resource,label = "CPU";
								resource,value = <0x0 0x11f1c0>;
							};

							resource@2 {
								resource,label = "DDR";
								resource,value = <0x0 0x0>;
							};
						};
					};

					booster_key@3 {
						input_booster,head_time = <0xc8>;
						input_booster,label = "touch";
						input_booster,tail_time = <0x12c>;
						input_booster,type = <0x2>;

						inputbooster,resource {
							compatible = "resource";

							resource@1 {
								resource,label = "CPU";
								resource,value = <0x14a910 0x11f1c0>;
							};

							resource@2 {
								resource,label = "DDR";
								resource,value = <0xe10 0xe10>;
							};
						};
					};

					booster_key@4 {
						input_booster,head_time = <0x3e8>;
						input_booster,label = "multitouch";
						input_booster,tail_time = <0x1f4>;
						input_booster,type = <0x3>;

						inputbooster,resource {
							compatible = "resource";

							resource@1 {
								resource,label = "CPU";
								resource,value = <0x14a910 0x11f1c0>;
							};

							resource@2 {
								resource,label = "DDR";
								resource,value = <0x0 0x0>;
							};
						};
					};

					booster_key@5 {
						input_booster,head_time = <0xc8>;
						input_booster,label = "keyboard";
						input_booster,tail_time = <0x0>;
						input_booster,type = <0x4>;

						inputbooster,resource {
							compatible = "resource";

							resource@1 {
								resource,label = "CPU";
								resource,value = <0x11f1c0 0x11f1c0>;
							};

							resource@2 {
								resource,label = "DDR";
								resource,value = <0x0 0x0>;
							};
						};
					};

					booster_key@6 {
						input_booster,head_time = <0xc8>;
						input_booster,label = "MOUSE";
						input_booster,tail_time = <0x12c>;
						input_booster,type = <0x5>;

						inputbooster,resource {
							compatible = "resource";

							resource@1 {
								resource,label = "CPU";
								resource,value = <0x14a910 0x11f1c0>;
							};

							resource@2 {
								resource,label = "DDR";
								resource,value = <0x0 0x0>;
							};
						};
					};

					booster_key@7 {
						input_booster,head_time = <0xc8>;
						input_booster,label = "mouse_wheel";
						input_booster,tail_time = <0x0>;
						input_booster,type = <0x6>;

						inputbooster,resource {
							compatible = "resource";

							resource@1 {
								resource,label = "CPU";
								resource,value = <0x14a910 0x0>;
							};

							resource@2 {
								resource,label = "DDR";
								resource,value = <0x0 0x0>;
							};
						};
					};

					booster_key@8 {
						input_booster,head_time = <0xc8>;
						input_booster,label = "pen_hover";
						input_booster,tail_time = <0x12c>;
						input_booster,type = <0x7>;

						inputbooster,resource {
							compatible = "resource";

							resource@1 {
								resource,label = "CPU";
								resource,value = <0x14a910 0x11f1c0>;
							};

							resource@2 {
								resource,label = "DDR";
								resource,value = <0x0 0x0>;
							};
						};
					};

					booster_key@9 {
						input_booster,head_time = <0xc8>;
						input_booster,label = "pen";
						input_booster,tail_time = <0x258>;
						input_booster,type = <0x8>;

						inputbooster,resource {
							compatible = "resource";

							resource@1 {
								resource,label = "CPU";
								resource,value = <0x14a910 0x11f1c0>;
							};

							resource@2 {
								resource,label = "DDR";
								resource,value = <0x0 0x0>;
							};
						};
					};
				};

				muic {
					dcd_timeout;
					new_factory;
				};

				s2mu106-charger {
					charger,lx_freq_recover;
					charger,mrstbtmr_factory = <0x2>;
					compatible = "samsung,s2mu106-charger";
					phandle = <0x85>;
					status = "disable";
				};

				sec-mst {
					compatible = "sec-mst";
					pinctrl-names = "default";
				};

				sec_abc {
					compatible = "samsung,sec_abc";
					status = "okay";

					aicl {
						aicl,label = "battery aicl";
						aicl,threshold_count = <0x5>;
						aicl,threshold_time = <0x12c>;
					};

					gpu {
						gpu,label = "GPU fault";
						gpu,threshold_count = <0x14>;
						gpu,threshold_time = <0x4b0>;
					};
				};

				sec_thermistor@0 {
					adc_array = <0x6a 0x7b 0xac 0xcc 0xf0 0x125 0x162 0x1aa 0x1ff 0x241 0x272 0x2f2 0x34a 0x3b2 0x462 0x53a 0x63c 0x755 0x7de 0x89d 0x964 0x9f0 0xb15 0xc67 0xd85>;
					compatible = "samsung,sec-thermistor";
					id = <0x0>;
					io-channel-names = "ap_therm";
					io-channel-ranges;
					io-channels = <0xffffffff 0x4>;
					phandle = <0x82>;
					status = "okay";
					temp_array = <0x352 0x320 0x2bc 0x28a 0x258 0x226 0x1f4 0x1c2 0x190 0x172 0x15e 0x12c 0x10e 0xfa 0xc8 0x96 0x64 0x32 0x1e 0x0 0xffffffe2 0xffffffce 0xffffff9c 0xffffff6a 0xffffff38>;
					thermistor_name = "sec-ap-thermistor";
					use_iio_processed;
				};

				sec_thermistor@1 {
					adc_array = <0x7e 0xa0 0xc1 0xdd 0x110 0x130 0x182 0x1c7 0x21e 0x263 0x299 0x311 0x35f 0x3b9 0x471 0x550 0x65d 0x764 0x80a 0x856 0x99b 0x9d0 0xa76 0xc73 0xd0b>;
					compatible = "samsung,sec-thermistor";
					id = <0x1>;
					io-channel-names = "pa_therm";
					io-channel-ranges;
					io-channels = <0xffffffff 0x0>;
					phandle = <0x81>;
					status = "okay";
					temp_array = <0x352 0x320 0x2bc 0x28a 0x258 0x226 0x1f4 0x1c2 0x190 0x172 0x15e 0x12c 0x10e 0xfa 0xc8 0x96 0x64 0x32 0x1e 0x0 0xffffffe2 0xffffffce 0xffffff9c 0xffffff6a 0xffffff38>;
					thermistor_name = "sec-pa-thermistor";
					use_iio_processed;
				};

				sec_thermistor@2 {
					adc_array = <0x6f 0x7d 0xaf 0xcf 0xf6 0x12a 0x165 0x1b2 0x20c 0x24f 0x281 0x305 0x365 0x3c7 0x477 0x557 0x652 0x772 0x7fb 0x8b9 0x987 0xa01 0xb4b 0xc88 0xd92>;
					compatible = "samsung,sec-thermistor";
					id = <0x2>;
					io-channel-names = "wf_therm";
					io-channel-ranges;
					io-channels = <0xffffffff 0x1>;
					phandle = <0x80>;
					status = "okay";
					temp_array = <0x352 0x320 0x2bc 0x28a 0x258 0x226 0x1f4 0x1c2 0x190 0x172 0x15e 0x12c 0x10e 0xfa 0xc8 0x96 0x64 0x32 0x1e 0x0 0xffffffe2 0xffffffce 0xffffff9c 0xffffff6a 0xffffff38>;
					thermistor_name = "sec-wf-thermistor";
					use_iio_processed;
				};
			};
		};
	};
};
